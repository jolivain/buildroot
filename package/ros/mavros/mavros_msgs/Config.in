## package/ros/mavros/tests_mavros/Config.in
```kconfig
config BR2_PACKAGE_TEST_MAVROS
	bool "test_mavros"
	help
	  Test package for mavros.

	  https://github.com/mavlink/mavros/tree/master/test_mavros
```

## package/ros/message_generation/Config.in
```kconfig
config BR2_PACKAGE_MESSAGE_GENERATION
	bool "message generation"
	select BR2_PACKAGE_GENCPP
	select BR2_PACKAGE_GENEUS
	select BR2_PACKAGE_GENLISP
	select BR2_PACKAGE_GENMSG
	select BR2_PACKAGE_GENNODEJS
	select BR2_PACKAGE_GENPY
	help
	  Package modeling the build-time dependencies for generating
	  language bindings of messages.

	  http://wiki.ros.org/message_generation
```

## package/ros/message_runtime/Config.in
```kconfig
config BR2_PACKAGE_MESSAGE_RUNTIME
	bool "message runtime"
	select BR2_PACKAGE_CPP_COMMON
	select BR2_PACKAGE_GENCPP
	select BR2_PACKAGE_ROSCPP_CORE_SET
	select BR2_PACKAGE_ROSCPP_SERIALIZATION
	help
	  Package modeling the run-time dependencies for language
	  bindings of messages.

	  http://wiki.ros.org/message_runtime
```

## package/ros/nodelet_core/Config.in
```kconfig
menuconfig BR2_PACKAGE_NODELET_CORE_SET
	bool "nodelet_core collection"

if BR2_PACKAGE_NODELET_CORE_SET
source "package/ros/nodelet_core/nodelet/Config.in"
source "package/ros/nodelet_core/nodelet_core/Config.in"
source "package/ros/nodelet_core/nodelet_topic_tools/Config.in"
source "package/ros/nodelet_core/test_nodelet/Config.in"
source "package/ros/nodelet_core/test_nodelet_topic_tools/Config.in"
endif
```

## package/ros/nodelet_core/nodelet/Config.in
```kconfig
config BR2_PACKAGE_NODELET
	bool "nodelet"
	select BR2_PACKAGE_PLUGINLIB
	select BR2_PACKAGE_BOND_CORE_SET
	select BR2_PACKAGE_BONDCPP
	select BR2_PACKAGE_CMAKE_MODULES
	select BR2_PACKAGE_MESSAGE_GENERATION
	select BR2_PACKAGE_ROS_COMM_SET
	select BR2_PACKAGE_ROSCONSOLE
	select BR2_PACKAGE_STD_MSGS
	help
	  The nodelet package is designed to provide a way to run
	  multiple algorithms in the same process with zero copy
	  transport between algorithms. This package provides both the
	  nodelet base class needed for implementing a nodelet, as
	  well as the NodeletLoader class used for instantiating
	  nodelets.

	  https://wiki.ros.org/nodelet
```

## package/ros/nodelet_core/nodelet_core/Config.in
```kconfig
config BR2_PACKAGE_NODELET_CORE
	bool "nodelet_core metapackage"
	select BR2_PACKAGE_NODELET
	select BR2_PACKAGE_NODELET_TOPIC_TOOLS
	help
	  Nodelet Core Metapackage. Nodelet Core Metapackage: it
	  contains necessary ros packages to work with ROS
	  nodelets. In ROS, each node is a process. A nodelet is
	  instead executed on a thread. The nodelet package is
	  designed to provide a way to run multiple algorithms in the
	  same process with zero copy transport between
	  algorithms. This package provides both the nodelet base
	  class needed for implementing a nodelet, as well as the
	  NodeletLoader class used for instantiating nodelets.

	  This metapackage selects common packages for this
	  collection.

	  https://wiki.ros.org/nodelet_core
```

## package/ros/nodelet_core/nodelet_topic_tools/Config.in
```kconfig
config BR2_PACKAGE_NODELET_TOPIC_TOOLS
	bool "nodelet_topic_tools"
	select BR2_PACKAGE_BOOST
	select BR2_PACKAGE_BOOST_THREAD
	select BR2_PACKAGE_DYNAMIC_RECONFIGURE
	help
	  This package contains common nodelet tools such as a mux,
	  demux and throttle.

	  http://wiki.ros.org/nodelet_topic_tools
```

## package/ros/nodelet_core/test_nodelet/Config.in
```kconfig
config BR2_PACKAGE_TEST_NODELET
	bool "test_nodelet"
	depends on BR2_PACKAGE_BOOST
	depends on BR2_PACKAGE_NODELET
	select BR2_PACKAGE_BOOST_THREAD
	select BR2_PACKAGE_ROSTEST
	help
	  Test package for nodelet.

	  https://wiki.ros.org/test_nodelet
```

## package/ros/nodelet_core/test_nodelet_topic_tools/Config.in
```kconfig
config BR2_PACKAGE_TEST_NODELET_TOPIC_TOOLS
	bool "test_nodelet_topic_tools"
	depends on BR2_PACKAGE_NODELET
	select BR2_PACKAGE_MESSAGE_FILTERS
	select BR2_PACKAGE_NODELET_TOPIC_TOOLS
	select BR2_PACKAGE_ROSCPP
	select BR2_PACKAGE_ROSTEST
	help
	  Test package for nodelet_topic_tools

	  https://wiki.ros.org/nodelet_topic_tools
```

## package/ros/orocos_kinematics_dynamics/orocos_kdl/Config.in
```kconfig
config BR2_PACKAGE_OROCOS_KDL
	bool "orocos_kdl"
	select BR2_PACKAGE_EIGEN
	help
	  Kinematics and Dynamics Library: Orocos project to supply
	  RealTime usable kinematics and dynamics code, it contains
	  code for rigid body kinematics calculations and
	  representations for kinematic structures and their inverse
	  and forward kinematic solvers.

	  http://wiki.ros.org/orocos_kdl
```

## package/ros/pluginlib/Config.in
```kconfig
config BR2_PACKAGE_PLUGINLIB
	bool "pluginlib"
	depends on BR2_PACKAGE_POCO_ARCH_SUPPORTS # class_loader
	#depends on BR2_PACKAGE_ROSPACK
	select BR2_PACKAGE_BOOST_FILESYSTEM
	select BR2_PACKAGE_BOOST_SYSTEM
	select BR2_PACKAGE_CLASS_LOADER
	select BR2_PACKAGE_ROSCONSOLE
	#select BR2_PACKAGE_ROSLIB
	#select BR2_PACKAGE_ROS_COMM_SET
	select BR2_PACKAGE_TINYXML2
	help
	  The pluginlib package provides tools for writing and
	  dynamically loading plugins using the ROS build
	  infrastructure.

	  http://wiki.ros.org/pluginlib
```

## package/ros/python-catkin_pkg/Config.in
```kconfig
config BR2_PACKAGE_PYTHON_CATKIN_PKG
	bool "python-catkin_pkg"
	select BR2_PACKAGE_PYTHON_DATEUTIL # runtime
	select BR2_PACKAGE_PYTHON_DOCUTILS # runtime
	select BR2_PACKAGE_PYTHON_PYPARSING # runtime
	select BR2_PACKAGE_PYTHON_SETUPTOOLS # runtime
	help
	  Standalone Python library for the catkin build system.

	  http://wiki.ros.org/catkin_pkg
```

## package/ros/python-catkin_pkg/Config.in.host
```kconfig
config BR2_PACKAGE_HOST_PYTHON_CATKIN_PKG
	bool "host python-catkin_pkg"
	select BR2_PACKAGE_HOST_PYTHON_PYPARSING # runtime
	help
	  Standalone Python library for the catkin build system.

	  http://wiki.ros.org/catkin_pkg
```

## package/ros/python-rosdep/Config.in
```kconfig
config BR2_PACKAGE_PYTHON_ROSDEP
	bool "python-rosdep"
	select BR2_PACKAGE_PYTHON_ROSDISTRO # runtime
	select BR2_PACKAGE_PYTHON3_SSL # runtime, for urllib https
	select BR2_PACKAGE_CA_CERTIFICATES # runtime, for urllib https
	help
	  rosdep package manager abstraction tool for ROS.

	  https://docs.ros.org/independent/api/rosdep/html/
```

## package/ros/python-rosdistro/Config.in
```kconfig
config BR2_PACKAGE_PYTHON_ROSDISTRO
	bool "python-rosdistro"
	help
	  A tool to work with rosdistro files.

	  https://pypi.org/project/rosdistro/
```

## package/ros/python-rospkg/Config.in
```kconfig
config BR2_PACKAGE_PYTHON_ROSPKG
	bool "python-rospkg"
	select BR2_PACKAGE_PYTHON3_PYEXPAT # runtime
	select BR2_PACKAGE_PYTHON_CATKIN_PKG # runtime
	select BR2_PACKAGE_PYTHON_DISTRO # runtime
	help
	  The rospkg Python module provides basic utilities for
	  querying information about ROS packages, stacks, and
	  distributions.

	  It is used at runtime by ros tools on target system, to
	  check and query installed ros package dependencies.

	  http://docs.ros.org/independent/api/rospkg/html/python_api.html
```

## package/ros/ros/Config.in
```kconfig
menuconfig BR2_PACKAGE_ROS_SET
	bool "ros collection"

if BR2_PACKAGE_ROS_SET
source "package/ros/ros/mk/Config.in"
source "package/ros/ros/ros/Config.in"
source "package/ros/ros/rosbash/Config.in"
source "package/ros/ros/rosboost_cfg/Config.in"
source "package/ros/ros/rosbuild/Config.in"
source "package/ros/ros/rosclean/Config.in"
source "package/ros/ros/roscreate/Config.in"
source "package/ros/ros/roslang/Config.in"
source "package/ros/ros/roslib/Config.in"
source "package/ros/ros/rosmake/Config.in"
source "package/ros/ros/rosunit/Config.in"
endif
```

## package/ros/ros/ros/Config.in
```kconfig
config BR2_PACKAGE_ROS
	bool "ros metapackage"
	select BR2_PACKAGE_MK
	select BR2_PACKAGE_ROSBASH
	select BR2_PACKAGE_ROSBOOST_CFG
	select BR2_PACKAGE_ROSBUILD
	select BR2_PACKAGE_ROSCLEAN
	select BR2_PACKAGE_ROSCREATE
	select BR2_PACKAGE_ROSLANG
	select BR2_PACKAGE_ROSLIB
	select BR2_PACKAGE_ROSMAKE
	select BR2_PACKAGE_ROSUNIT
	help
	  ros metapackage.

	  This metapackage selects common packages for this
	  collection.

	  https://wiki.ros.org/ros
```

## package/ros/ros/rosbash/Config.in
```kconfig
config BR2_PACKAGE_ROSBASH
	bool "rosbash"
	select BR2_PACKAGE_BUSYBOX_SHOW_OTHERS
	select BR2_PACKAGE_BASH
	select BR2_PACKAGE_FINDUTILS
	help
	  Assorted shell commands for using ros with bash.

	  https://wiki.ros.org/rosbash
```

## package/ros/ros/rosboost_cfg/Config.in
```kconfig
config BR2_PACKAGE_ROSBOOST_CFG
	bool "rosboost_cfg"
	help
	  Contains scripts used by the rosboost-cfg tool for
	  determining cflags/lflags/etc. of boost on your system.

	  https://wiki.ros.org/rosboost_cfg
```

## package/ros/ros/rosclean/Config.in
```kconfig
config BR2_PACKAGE_ROSCLEAN
	bool "rosclean"
	help
	  rosclean: cleanup filesystem resources (e.g. log files).

	  https://wiki.ros.org/rosclean
```

## package/ros/ros/roslang/Config.in
```kconfig
config BR2_PACKAGE_ROSLANG
	bool "roslang"
	help
	  roslang is a common package that all ROS client libraries
	  depend on.

	  https://wiki.ros.org/roslang
```

## package/ros/ros/roslib/Config.in
```kconfig
config BR2_PACKAGE_ROSLIB
	bool "roslib"
	select BR2_PACKAGE_CATKIN # runtime
	select BR2_PACKAGE_ROSPACK # runtime
	help
	  Base dependencies and support libraries for ROS. roslib
	  contains many of the common data structures and tools that
	  are shared across ROS client library implementations.

	  https://wiki.ros.org/roslib
```
