## package/ros/common_msgs/actionlib_msgs/Config.in
```kconfig
config BR2_PACKAGE_ACTIONLIB_MSGS
	bool "actionlib_msgs"
	help
	  actionlib_msgs defines the common messages to interact with
	  an action server and an action client. For full
	  documentation of the actionlib API see the actionlib
	  package.

	  https://wiki.ros.org/actionlib_msgs
```

## package/ros/common_msgs/common_msgs/Config.in
```kconfig
config BR2_PACKAGE_COMMON_MSGS
	bool "common_msgs metapackage"
	select BR2_PACKAGE_ACTIONLIB_MSGS # runtime
	select BR2_PACKAGE_DIAGNOSTIC_MSGS # runtime
	select BR2_PACKAGE_GEOMETRY_MSGS # runtime
	select BR2_PACKAGE_NAV_MSGS # runtime
	select BR2_PACKAGE_SENSOR_MSGS # runtime
	select BR2_PACKAGE_SHAPE_MSGS # runtime
	select BR2_PACKAGE_STEREO_MSGS # runtime
	select BR2_PACKAGE_TRAJECTORY_MSGS # runtime
	select BR2_PACKAGE_VISUALIZATION_MSGS # runtime
	help
	  common_msgs contains messages that are widely used by other
	  ROS packages. These includes messages for actions
	  (actionlib_msgs), diagnostics (diagnostic_msgs), geometric
	  primitives (geometry_msgs), robot navigation (nav_msgs), and
	  common sensors (sensor_msgs), such as laser range finders,
	  cameras, point clouds.

	  This metapackage selects common packages for this
	  collection.

	  http://wiki.ros.org/common_msgs
```

## package/ros/common_msgs/diagnostic_msgs/Config.in
```kconfig
config BR2_PACKAGE_DIAGNOSTIC_MSGS
	bool "diagnostic_msgs"
	help
	  This package holds the diagnostic messages which provide the
	  standardized interface for the diagnostic and runtime
	  monitoring systems in ROS. These messages are currently used
	  by the diagnostics Stack, which provides libraries for
	  simple ways to set and access the messages, as well as
	  automated ways to process the diagnostic data. These
	  messages are used for long term logging and will not be
	  changed unless there is a very important reason.

	  http://wiki.ros.org/diagnostic_msgs
```

## package/ros/common_msgs/geometry_msgs/Config.in
```kconfig
config BR2_PACKAGE_GEOMETRY_MSGS
	bool "geometry_msgs"
	help
	  geometry_msgs provides messages for common geometric
	  primitives such as points, vectors, and poses. These
	  primitives are designed to provide a common data type and
	  facilitate interoperability throughout the system.

	  http://wiki.ros.org/geometry_msgs
```

## package/ros/common_msgs/nav_msgs/Config.in
```kconfig
config BR2_PACKAGE_NAV_MSGS
	bool "nav_msgs"
	select BR2_PACKAGE_ACTIONLIB_MSGS
	select BR2_PACKAGE_GEOMETRY_MSGS
	help
	  nav_msgs defines the common messages used to interact with
	  the navigation stack.

	  http://wiki.ros.org/nav_msgs
```

## package/ros/common_msgs/stereo_msgs/Config.in
```kconfig
config BR2_PACKAGE_STEREO_MSGS
	bool "stereo_msgs"
	select BR2_PACKAGE_SENSOR_MSGS
	help
	  stereo_msgs contains messages specific to stereo processing,
	  such as disparity images.

	  http://wiki.ros.org/stereo_msgs
```

## package/ros/common_msgs/trajectory_msgs/Config.in
```kconfig
config BR2_PACKAGE_TRAJECTORY_MSGS
	bool "trajectory_msgs"
	select BR2_PACKAGE_GEOMETRY_MSGS
	help
	  This package defines messages for defining robot
	  trajectories. These messages are also the building blocks of
	  most of the control_msgs actions.

	  http://wiki.ros.org/trajectory_msgs
```

## package/ros/common_msgs/visualization_msgs/Config.in
```kconfig
config BR2_PACKAGE_VISUALIZATION_MSGS
	bool "visualization_msgs"
	select BR2_PACKAGE_GEOMETRY_MSGS
	help
	  visualization_msgs is a set of messages used by higher level
	  packages, such as rviz, that deal in visualization-specific
	  data. The main messages in visualization_msgs is
	  visualization_msgs/Marker. The marker message is used to
	  send visualization "markers" such as boxes, spheres, arrows,
	  lines, etc. to a visualization environment such as rviz.

	  http://wiki.ros.org/visualization_msgs
```

## package/ros/diagnostics/Config.in
```kconfig
menuconfig BR2_PACKAGE_DIAGNOSTICS_SET
	bool "diagnostics collection"

if BR2_PACKAGE_DIAGNOSTICS_SET
source "package/ros/diagnostics/diagnostic_aggregator/Config.in"
source "package/ros/diagnostics/diagnostic_analysis/Config.in"
source "package/ros/diagnostics/diagnostic_common_diagnostics/Config.in"
source "package/ros/diagnostics/diagnostic_updater/Config.in"
source "package/ros/diagnostics/diagnostics/Config.in"
source "package/ros/diagnostics/rosdiagnostic/Config.in"
source "package/ros/diagnostics/self_test/Config.in"
endif
```

## package/ros/diagnostics/diagnostic_aggregator/Config.in
```kconfig
config BR2_PACKAGE_DIAGNOSTIC_AGGREGATOR
	bool "diagnostic_aggregator"
	select BR2_PACKAGE_BONDCPP
	select BR2_PACKAGE_BONDPY
	select BR2_PACKAGE_BOND_CORE_SET
	select BR2_PACKAGE_COMMON_MSGS_SET
	select BR2_PACKAGE_DIAGNOSTIC_MSGS
	select BR2_PACKAGE_PLUGINLIB
	select BR2_PACKAGE_ROSCPP
	select BR2_PACKAGE_ROSPY
	select BR2_PACKAGE_ROSTEST
	select BR2_PACKAGE_ROS_SET
	select BR2_PACKAGE_XMLRPCPP
	help
	  The diagnostic_aggregator contains a ROS node,
	  aggregator_node, that listens to
	  diagnostic_msgs/DiagnosticArray messages on the /diagnostics
	  topic, processes and categorizes the data, and republishes
	  on /diagnostics_agg. The aggregator_node loads "Analyzer"
	  plugins to perform the diagnostics processing and
	  categorization. The configuration and setup for each
	  diagnostic aggregator is specific to each robot and can be
	  determined by users or developers.

	  http://wiki.ros.org/diagnostic_aggregator
```

## package/ros/diagnostics/diagnostic_analysis/Config.in
```kconfig
config BR2_PACKAGE_DIAGNOSTIC_ANALYSIS
	bool "diagnostic_analysis"
	select BR2_PACKAGE_COMMON_MSGS_SET
	select BR2_PACKAGE_DIAGNOSTIC_MSGS
	select BR2_PACKAGE_ROSBAG
	select BR2_PACKAGE_ROSLIB
	select BR2_PACKAGE_ROSTEST
	select BR2_PACKAGE_ROS_COMM_SET
	select BR2_PACKAGE_ROS_SET
	help
	  The diagnostic_analysis package can convert a log of
	  diagnostics data into a series of CSV files. Robot logs are
	  recorded with rosbag, and can be processed offline using the
	  scripts in this package.

	  http://wiki.ros.org/diagnostic_analysis
```

## package/ros/diagnostics/diagnostic_common_diagnostics/Config.in
```kconfig
config BR2_PACKAGE_DIAGNOSTIC_COMMON_DIAGNOSTICS
	bool "diagnostic_common_diagnostics"
	select BR2_PACKAGE_DIAGNOSTIC_UPDATER
	select BR2_PACKAGE_GEOMETRY_SET
	select BR2_PACKAGE_ROSPY
	select BR2_PACKAGE_ROSTEST
	select BR2_PACKAGE_ROS_COMM_SET
	select BR2_PACKAGE_TF
	help
	  diagnostic_common_diagnostics: This package provides generic
	  nodes for monitoring a linux host.

	  http://wiki.ros.org/diagnostic_common_diagnostics
```

## package/ros/diagnostics/diagnostic_updater/Config.in
```kconfig
config BR2_PACKAGE_DIAGNOSTIC_UPDATER
	bool "diagnostic_updater"
	select BR2_PACKAGE_DIAGNOSTIC_MSGS
	select BR2_PACKAGE_ROS_COMM_SET
	select BR2_PACKAGE_ROSCPP
	select BR2_PACKAGE_ROSTEST
	select BR2_PACKAGE_STD_MSGS
	help
	  diagnostic_updater contains tools for easily updating
	  diagnostics. it is commonly used in device drivers to keep
	  track of the status of output topics, device status, etc.

	  http://wiki.ros.org/diagnostic_updater
```

## package/ros/diagnostics/diagnostics/Config.in
```kconfig
config BR2_PACKAGE_DIAGNOSTICS
	bool "diagnostics metapackage"
	select BR2_PACKAGE_DIAGNOSTIC_AGGREGATOR # runtime
	select BR2_PACKAGE_DIAGNOSTIC_ANALYSIS # runtime
	select BR2_PACKAGE_DIAGNOSTIC_COMMON_DIAGNOSTICS # runtime
	select BR2_PACKAGE_DIAGNOSTIC_UPDATER # runtime
	select BR2_PACKAGE_SELF_TEST # runtime
	help
	  The diagnostics system is designed to collect information
	  from hardware drivers and robot hardware to users and
	  operators for analysis, troubleshooting, and logging. The
	  diagnostics stack contains tools for collecting, publishing,
	  analyzing and viewing diagnostics data.

	  This metapackage selects common packages for this
	  collection.

	  http://wiki.ros.org/diagnostics
```

## package/ros/diagnostics/rosdiagnostic/Config.in
```kconfig
config BR2_PACKAGE_ROSDIAGNOSTIC
	bool "rosdiagnostic"
	select BR2_PACKAGE_COMMON_MSGS_SET
	select BR2_PACKAGE_DIAGNOSTIC_MSGS # runtime
	select BR2_PACKAGE_ROSPY # runtime
	select BR2_PACKAGE_ROS_COMM_SET
	help
	  Command to print aggregated diagnostic contents to the
	  command line.

	  https://github.com/ros/diagnostics/tree/noetic-devel/rosdiagnostic
```

## package/ros/diagnostics/self_test/Config.in
```kconfig
config BR2_PACKAGE_SELF_TEST
	bool "self_test"
	select BR2_PACKAGE_DIAGNOSTIC_MSGS
	select BR2_PACKAGE_DIAGNOSTIC_UPDATER
	select BR2_PACKAGE_ROSCPP
	help
	  self_test
```

## package/ros/dynamic_reconfigure/Config.in
```kconfig
config BR2_PACKAGE_DYNAMIC_RECONFIGURE
	bool "dynamic reconfigure"
	select BR2_PACKAGE_PYTHON_ROSPKG
	select BR2_PACKAGE_ROSCPP
	select BR2_PACKAGE_ROSLIB
	select BR2_PACKAGE_ROSPACK
	select BR2_PACKAGE_ROSTEST
	select BR2_PACKAGE_ROS_COMM_SET
	select BR2_PACKAGE_ROS_SET
	help
	  The dynamic_reconfigure package provides a means to update
	  parameters at runtime without having to restart the node.

	  http://wiki.ros.org/dynamic_reconfigure
```

## package/ros/gencpp/Config.in
```kconfig
config BR2_PACKAGE_GENCPP
	bool "gencpp"
	select BR2_PACKAGE_GENMSG
	help
	  C++ ROS message and service generators.

	  http://wiki.ros.org/gencpp
```

## package/ros/genlisp/Config.in
```kconfig
config BR2_PACKAGE_GENLISP
	bool "genlisp"
	select BR2_PACKAGE_GENMSG
	help
	  Common-Lisp message and service generation for ROS.

	  http://wiki.ros.org/genlisp
```

## package/ros/genmsg/Config.in
```kconfig
config BR2_PACKAGE_GENMSG
	bool "genmsg"
	help
	  Standalone Python library for generating ROS message and
	  service data structures for various languages.

	  http://wiki.ros.org/genmsg
```

## package/ros/gennodejs/Config.in
```kconfig
config BR2_PACKAGE_GENNODEJS
	bool "gennodejs"
	select BR2_PACKAGE_GENMSG
	help
	  This package generates the Javascript messages for ROS
	  packages and is used by rosnodejs.

	  http://wiki.ros.org/gennodejs
```

## package/ros/genpy/Config.in
```kconfig
config BR2_PACKAGE_GENPY
	bool "genpy"
	select BR2_PACKAGE_GENMSG
	help
	  Python ROS message and service generators.

	  http://wiki.ros.org/genpy
```

## package/ros/geographic_info/Config.in
```kconfig
menuconfig BR2_PACKAGE_GEOGRAPHIC_INFO_SET
	bool "geographic_info collection"

if BR2_PACKAGE_GEOGRAPHIC_INFO_SET
source "package/ros/geographic_info/geographic_msgs/Config.in"
endif
```

## package/ros/geographic_info/geographic_msgs/Config.in
```kconfig
config BR2_PACKAGE_GEOGRAPHIC_MSGS
	bool "geographic_msgs"
	select BR2_PACKAGE_GEOMETRY_MSGS
	select BR2_PACKAGE_MESSAGE_GENERATION
	select BR2_PACKAGE_MESSAGE_RUNTIME # runtime
	select BR2_PACKAGE_STD_MSGS
	select BR2_PACKAGE_UNIQUE_IDENTIFIER_SET
	select BR2_PACKAGE_UUID_MSGS
	help
	  ROS messages for Geographic Information Systems.

	  http://wiki.ros.org/geographic_msgs
```

## package/ros/geometry/Config.in
```kconfig
menuconfig BR2_PACKAGE_GEOMETRY_SET
	bool "geometry collection"

if BR2_PACKAGE_GEOMETRY_SET
source "package/ros/geometry/eigen_conversions/Config.in"
source "package/ros/geometry/geometry/Config.in"
source "package/ros/geometry/kdl_conversions/Config.in"
source "package/ros/geometry/tf/Config.in"
source "package/ros/geometry/tf_conversions/Config.in"
endif
```
