## package/ros/ros/rosunit/Config.in
```kconfig
config BR2_PACKAGE_ROSUNIT
	bool "rosunit"
	help
	  rosunit is an internal tool for running unit tests within
	  ROS. While it can be run by a regular user, most users will
	  generally use rosunit indirectly via rosbuild test
	  macros. The main feature that rosunit provides is
	  terminating a unit test based on a timeout and generating an
	  appropriate test failure. The rosbuild system uses this
	  feature to ensure that unit tests properly terminate.

	  https://wiki.ros.org/rosunit
```

## package/ros/ros_comm/Config.in
```kconfig
menuconfig BR2_PACKAGE_ROS_COMM_SET
	bool "ros_comm collection"

if BR2_PACKAGE_ROS_COMM_SET
source "package/ros/ros_comm/message_filters/Config.in"
source "package/ros/ros_comm/ros_comm/Config.in"
source "package/ros/ros_comm/rosbag/Config.in"
source "package/ros/ros_comm/rosbag_storage/Config.in"
source "package/ros/ros_comm/roscpp/Config.in"
source "package/ros/ros_comm/rosgraph/Config.in"
source "package/ros/ros_comm/roslaunch/Config.in"
source "package/ros/ros_comm/roslz4/Config.in"
source "package/ros/ros_comm/rosmaster/Config.in"
source "package/ros/ros_comm/rosmsg/Config.in"
source "package/ros/ros_comm/rosnode/Config.in"
source "package/ros/ros_comm/rosout/Config.in"
source "package/ros/ros_comm/rosparam/Config.in"
source "package/ros/ros_comm/rospy/Config.in"
source "package/ros/ros_comm/rosservice/Config.in"
source "package/ros/ros_comm/rostest/Config.in"
source "package/ros/ros_comm/rostopic/Config.in"
source "package/ros/ros_comm/roswtf/Config.in"
source "package/ros/ros_comm/topic_tools/Config.in"
source "package/ros/ros_comm/xmlrpcpp/Config.in"
endif
```

## package/ros/ros_comm/message_filters/Config.in
```kconfig
config BR2_PACKAGE_MESSAGE_FILTERS
	bool "message_filters"
	select BR2_PACKAGE_BOOST_THREAD
	select BR2_PACKAGE_ROSCONSOLE
	select BR2_PACKAGE_ROSCPP
	select BR2_PACKAGE_ROSTEST
	help
	  A set of message filters which take in messages and may
	  output those messages at a later time, based on the
	  conditions that filter needs met.

	  https://wiki.ros.org/message_filters
```

## package/ros/ros_comm/ros_comm/Config.in
```kconfig
config BR2_PACKAGE_ROS_COMM
	bool "ros_comm metapackage"
	select BR2_PACKAGE_COMMON_MSGS_SET
	select BR2_PACKAGE_MESSAGE_FILTERS
	select BR2_PACKAGE_ROS
	select BR2_PACKAGE_ROSBAG
	select BR2_PACKAGE_ROSCONSOLE
	select BR2_PACKAGE_ROSCPP
	select BR2_PACKAGE_ROSGRAPH
	select BR2_PACKAGE_ROSGRAPH_MSGS
	select BR2_PACKAGE_ROSLAUNCH
	#select BR2_PACKAGE_ROSLISP
	select BR2_PACKAGE_ROSMASTER
	select BR2_PACKAGE_ROSMSG
	select BR2_PACKAGE_ROSNODE
	select BR2_PACKAGE_ROSOUT
	select BR2_PACKAGE_ROSPARAM
	select BR2_PACKAGE_ROSPY
	select BR2_PACKAGE_ROSSERVICE
	select BR2_PACKAGE_ROSTEST
	select BR2_PACKAGE_ROSTOPIC
	select BR2_PACKAGE_ROSWTF
	select BR2_PACKAGE_STD_SRVS
	select BR2_PACKAGE_TOPIC_TOOLS
	select BR2_PACKAGE_XMLRPCPP
	help
	  ros_comm metapackage: ROS communications-related packages,
	  including core client libraries (roscpp, rospy) and graph
	  introspection tools (rostopic, rosnode, rosservice,
	  rosparam).

	  This metapackage selects common packages for this
	  collection.

	  http://wiki.ros.org/ros_comm
```

## package/ros/ros_comm/rosbag/Config.in
```kconfig
config BR2_PACKAGE_ROSBAG
	bool "rosbag"
	select BR2_PACKAGE_BOOST_DATE_TIME
	select BR2_PACKAGE_BOOST_FILESYSTEM
	select BR2_PACKAGE_BOOST_PROGRAM_OPTIONS
	select BR2_PACKAGE_BOOST_REGEX
	select BR2_PACKAGE_BZIP2
	select BR2_PACKAGE_CPP_COMMON
	select BR2_PACKAGE_GENMSG
	select BR2_PACKAGE_GENPY
	select BR2_PACKAGE_PYTHON_GNUPG # runtime
	select BR2_PACKAGE_PYTHON_PYCRYPTODOMEX # runtime
	select BR2_PACKAGE_PYTHON_ROSPKG # runtime
	select BR2_PACKAGE_ROSBAG_STORAGE
	select BR2_PACKAGE_ROSCONSOLE
	select BR2_PACKAGE_ROSCPP
	select BR2_PACKAGE_ROSCPP_CORE_SET
	select BR2_PACKAGE_ROSCPP_SERIALIZATION
	select BR2_PACKAGE_ROSLIB
	select BR2_PACKAGE_ROSPY
	select BR2_PACKAGE_STD_SRVS
	select BR2_PACKAGE_TOPIC_TOOLS
	select BR2_PACKAGE_XMLRPCPP
	help
	  This is a set of tools for recording from and playing back
	  to ROS topics. It's intended to be high performance and
	  avoids deserialization and reserialization of the messages.

	  https://wiki.ros.org/rosbag
```

## package/ros/ros_comm/rosbag_storage/Config.in
```kconfig
config BR2_PACKAGE_ROSBAG_STORAGE
	bool "rosbag_storage"
	select BR2_PACKAGE_CPP_COMMON
	select BR2_PACKAGE_LIBGPGME
	select BR2_PACKAGE_PLUGINLIB
	select BR2_PACKAGE_ROSCPP_CORE_SET
	select BR2_PACKAGE_ROSCPP_SERIALIZATION
	select BR2_PACKAGE_ROSCPP_TRAITS
	select BR2_PACKAGE_ROSLZ4
	select BR2_PACKAGE_ROSTIME
	select BR2_PACKAGE_STD_MSGS
	help
	  This is a set of tools for recording from and playing back
	  ROS message without relying on the ROS client library.

	  http://wiki.ros.org/rosbag_storage
```

## package/ros/ros_comm/rosgraph/Config.in
```kconfig
config BR2_PACKAGE_ROSGRAPH
	bool "rosgraph"
	depends on BR2_PACKAGE_PYTHON3
	select BR2_PACKAGE_PYTHON_NETIFACES # runtime
	select BR2_PACKAGE_PYTHON_ROSPKG # runtime
	help
	  rosgraph contains the rosgraph command-line tool, which
	  prints information about the ROS Computation Graph. It also
	  provides an internal library that is used by the graphical
	  version of this tool, rxgraph.

	  https://wiki.ros.org/rosgraph
```

## package/ros/ros_comm/roslaunch/Config.in
```kconfig
config BR2_PACKAGE_ROSLAUNCH
	bool "roslaunch"
	select BR2_PACKAGE_COMMON_MSGS_SET
	select BR2_PACKAGE_PYTHON_PYYAML # runtime
	select BR2_PACKAGE_PYTHON_ROSPKG # runtime
	select BR2_PACKAGE_ROSCLEAN # runtime
	select BR2_PACKAGE_ROSGRAPH_MSGS # runtime
	select BR2_PACKAGE_ROSLIB # runtime
	select BR2_PACKAGE_ROSMASTER # runtime
	select BR2_PACKAGE_ROSOUT # runtime
	select BR2_PACKAGE_ROSPARAM # runtime
	select BR2_PACKAGE_ROSUNIT # runtime
	help
	  roslaunch is a tool for easily launching multiple ROS nodes
	  locally and remotely via SSH, as well as setting parameters
	  on the Parameter Server.

	  https://wiki.ros.org/roslaunch
```

## package/ros/ros_comm/roslz4/Config.in
```kconfig
config BR2_PACKAGE_ROSLZ4
	bool "roslz4"
	select BR2_PACKAGE_LZ4
	select BR2_PACKAGE_CPP_COMMON
	select BR2_PACKAGE_ROSCPP_CORE_SET
	help
	  A Python and C++ implementation of the LZ4 streaming format.

	  https://wiki.ros.org/roslz4
```

## package/ros/ros_comm/rosmaster/Config.in
```kconfig
config BR2_PACKAGE_ROSMASTER
	bool "rosmaster"
	select BR2_PACKAGE_PYTHON_DEFUSEDXML
	help
	  ROS Master implementation.

	  https://wiki.ros.org/rosmaster
```

## package/ros/ros_comm/rosmsg/Config.in
```kconfig
config BR2_PACKAGE_ROSMSG
	bool "rosmsg"
	select BR2_PACKAGE_ROSBAG
	select BR2_PACKAGE_ROSLIB
	select BR2_PACKAGE_ROS_SET
	help
	  rosmsg contains two command-line tools: rosmsg and rossrv,
	  rosmsg is a command-line tools for displaying information
	  about ROS Message types. rossrv is a command-line tool for
	  displaying information about ROS Service types.

	  http://wiki.ros.org/rosmsg
```

## package/ros/ros_comm/rosnode/Config.in
```kconfig
config BR2_PACKAGE_ROSNODE
	bool "rosnode"
	select BR2_PACKAGE_ROSTEST
	help
	  rosnode is a command-line tool for displaying debug
	  information about ROS Nodes, including publications,
	  subscriptions and connections

	  http://wiki.ros.org/rosnode
```

## package/ros/ros_comm/rosout/Config.in
```kconfig
config BR2_PACKAGE_ROSOUT
	bool "rosout"
	select BR2_PACKAGE_COMMON_MSGS_SET
	select BR2_PACKAGE_ROSCPP
	select BR2_PACKAGE_ROSGRAPH_MSGS
	select BR2_PACKAGE_ROS_COMM_MSGS
	help
	  System-wide logging mechanism for message sent to the rosout
	  topic.

	  http://wiki.ros.org/rosout
```

## package/ros/ros_comm/rosservice/Config.in
```kconfig
config BR2_PACKAGE_ROSSERVICE
	bool "rosservice"
	help
	  rosservice contains the rosservice command-line tool for
	  listing and querying ROS Services. It also contains a Python
	  library for retrieving information about Services and
	  dynamically invoking them.

	  http://wiki.ros.org/rosservice
```

## package/ros/ros_comm/rostest/Config.in
```kconfig
config BR2_PACKAGE_ROSTEST
	bool "rostest"
	select BR2_PACKAGE_BOOST_SYSTEM
	select BR2_PACKAGE_BOOST_THREAD
	select BR2_PACKAGE_ROSUNIT
	select BR2_PACKAGE_ROS_SET
	help
	  rostest is an extension to roslaunch that enables roslaunch
	  files to be used as test fixtures. As a fully running system
	  has more complex behaviors than an individual ROS node, this
	  allows you to do full integration testing across multiple
	  nodes.

	  http://wiki.ros.org/rostest
```

## package/ros/ros_comm/topic_tools/Config.in
```kconfig
config BR2_PACKAGE_TOPIC_TOOLS
	bool "topic_tools"
	select BR2_PACKAGE_CPP_COMMON
	select BR2_PACKAGE_MESSAGE_GENERATION
	select BR2_PACKAGE_ROSCONSOLE
	select BR2_PACKAGE_ROSCPP
	select BR2_PACKAGE_ROSCPP_CORE_SET
	select BR2_PACKAGE_ROSTEST
	select BR2_PACKAGE_ROSTIME
	select BR2_PACKAGE_STD_MSGS
	select BR2_PACKAGE_XMLRPCPP
	help
	  Tools for directing, throttling, selecting, and otherwise
	  messing with ROS topics at a meta level. None of the
	  programs in this package actually know about the topics
	  whose streams they are altering; instead, these tools deal
	  with messages as generic binary blobs. This means they can
	  be applied to any ROS topic.

	  http://wiki.ros.org/topic_tools
```

## package/ros/ros_comm_msgs/Config.in
```kconfig
menuconfig BR2_PACKAGE_ROS_COMM_MSGS_SET
	bool "ros_comm_msgs collection"

if BR2_PACKAGE_ROS_COMM_MSGS_SET
source "package/ros/ros_comm_msgs/rosgraph_msgs/Config.in"
source "package/ros/ros_comm_msgs/std_srvs/Config.in"
endif
```

## package/ros/ros_comm_msgs/rosgraph_msgs/Config.in
```kconfig
config BR2_PACKAGE_ROSGRAPH_MSGS
	bool "rosgraph_msgs"
	select BR2_PACKAGE_MESSAGE_GENERATION
	select BR2_PACKAGE_STD_MSGS
	help
	  Messages relating to the ROS Computation Graph. These are
	  generally considered to be low-level messages that end users
	  do not interact with.

	  https://wiki.ros.org/rosgraph_msgs
```

## package/ros/ros_comm_msgs/std_srvs/Config.in
```kconfig
config BR2_PACKAGE_STD_SRVS
	bool "std_srvs"
	select BR2_PACKAGE_MESSAGE_GENERATION
	select BR2_PACKAGE_MESSAGE_RUNTIME # runtime
	help
	  Common service definitions.

	  https://wiki.ros.org/std_srvs
```

## package/ros/ros_environment/Config.in
```kconfig
config BR2_PACKAGE_ROS_ENVIRONMENT
	bool "ros_environment"
	help
	  The package provides the environment variables
	  'ROS_VERSION', 'ROS_DISTRO', 'ROS_PACKAGE_PATH', and
	  'ROS_ETC_DIR'.

	  http://wiki.ros.org/ros_environment

if BR2_PACKAGE_ROS_ENVIRONMENT
config BR2_PACKAGE_ROS_ENVIRONMENT_INSTALL_PROFILE
	bool "Install ros shell profile"
	help
	  Installs the ROS shell in /etc/profile.d.  ROS environment
	  will be activated at login.

	  If not installed, ROS environment will need to be activated
	  manually, with command:
	  ". /opt/ros/$(rosversion -d)/setup.sh"

endif
```

## package/ros/ros_tutorials/Config.in
```kconfig
menuconfig BR2_PACKAGE_ROS_TUTORIALS_SET
	bool "ros_tutorials collection"

if BR2_PACKAGE_ROS_TUTORIALS_SET
source "package/ros/ros_tutorials/roscpp_tutorials/Config.in"
source "package/ros/ros_tutorials/rospy_tutorials/Config.in"
endif
```

## package/ros/ros_tutorials/roscpp_tutorials/Config.in
```kconfig
config BR2_PACKAGE_ROSCPP_TUTORIALS
	bool "roscpp_tutorials"
	depends on !BR2_TOOLCHAIN_HAS_GCC_BUG_64735 # boost-thread
	select BR2_PACKAGE_BOOST_DATE_TIME
	select BR2_PACKAGE_BOOST_THREAD # roscpp
	select BR2_PACKAGE_MESSAGE_GENERATION
	select BR2_PACKAGE_ROSCONSOLE
	select BR2_PACKAGE_ROSCPP
	select BR2_PACKAGE_ROSCPP_CORE_SET
	select BR2_PACKAGE_ROSCPP_SERIALIZATION
	select BR2_PACKAGE_ROSTIME
	select BR2_PACKAGE_ROS_COMM_SET
	select BR2_PACKAGE_STD_MSGS
	help
	  This package attempts to show the features of ROS
	  step-by-step, including using messages, servers, parameters,
	  etc.

	  https://wiki.ros.org/roscpp_tutorials
```

## package/ros/ros_tutorials/rospy_tutorials/Config.in
```kconfig
config BR2_PACKAGE_ROSPY_TUTORIALS
	bool "rospy_toturials"
	help
	  This package attempts to show the features of ROS python API
	  step-by-step, including using messages, servers, parameters,
	  etc. These tutorials are compatible with the nodes in
	  roscpp_tutorial.

	  https://wiki.ros.org/rospy_tutorials
```

## package/ros/rosconsole/Config.in
```kconfig
config BR2_PACKAGE_ROSCONSOLE
	bool "rosconsole"
	depends on !BR2_TOOLCHAIN_HAS_GCC_BUG_64735 # boost-thread
	select BR2_PACKAGE_BOOST_REGEX
	select BR2_PACKAGE_BOOST_SYSTEM
	select BR2_PACKAGE_BOOST_THREAD
	select BR2_PACKAGE_CPP_COMMON
	select BR2_PACKAGE_LOG4CXX
	select BR2_PACKAGE_ROSCPP_CORE_SET
	select BR2_PACKAGE_ROSUNIT
	select BR2_PACKAGE_ROS_SET
	help
	  ROS console output library.

	  https://wiki.ros.org/rosconsole
```

## package/ros/rosconsole_bridge/Config.in
```kconfig
config BR2_PACKAGE_ROSCONSOLE_BRIDGE
	bool "rosconsole_bridge"
	select BR2_PACKAGE_CPP_COMMON
	select BR2_PACKAGE_ROSCONSOLE
	select BR2_PACKAGE_ROSCPP_CORE_SET
	help
	  rosconsole_bridge is a package used in conjunction with
	  console_bridge and rosconsole for connecting
	  console_bridge-based logging to rosconsole-based logging.

	  https://wiki.ros.org/rosconsole_bridge
```
