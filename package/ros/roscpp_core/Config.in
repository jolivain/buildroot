## package/ros/roscpp_core/Config.in
```kconfig
menuconfig BR2_PACKAGE_ROSCPP_CORE_SET
	bool "roscpp_core collection"

if BR2_PACKAGE_ROSCPP_CORE_SET
source "package/ros/roscpp_core/cpp_common/Config.in"
source "package/ros/roscpp_core/roscpp_core/Config.in"
source "package/ros/roscpp_core/roscpp_serialization/Config.in"
source "package/ros/roscpp_core/roscpp_traits/Config.in"
source "package/ros/roscpp_core/rostime/Config.in"
endif
```

## package/ros/roscpp_core/roscpp_core/Config.in
```kconfig
config BR2_PACKAGE_ROSCPP_CORE
	bool "roscpp_core metapackage"
	select BR2_PACKAGE_CPP_COMMON
	select BR2_PACKAGE_ROSTIME
	select BR2_PACKAGE_ROSCPP_TRAITS
	select BR2_PACKAGE_ROSCPP_SERIALIZATION
	help
	  roscpp_core is an underlying library for support roscpp
	  message data types. It is a lightweight/minimal library that
	  can easily be used in non-ROS-based projects.

	  This metapackage selects common packages for this
	  collection.

	  https://wiki.ros.org/roscpp_core
```

## package/ros/roscpp_core/roscpp_serialization/Config.in
```kconfig
config BR2_PACKAGE_ROSCPP_SERIALIZATION
	bool "roscpp_serialization"
	select BR2_PACKAGE_CPP_COMMON
	select BR2_PACKAGE_ROSCPP_TRAITS
	select BR2_PACKAGE_ROSTIME
	help
	  roscpp_serialization contains the code for serialization as
	  described in MessagesSerializationAndAdaptingTypes.

	  https://wiki.ros.org/roscpp_serialization
```

## package/ros/roscpp_core/roscpp_traits/Config.in
```kconfig
config BR2_PACKAGE_ROSCPP_TRAITS
	bool "roscpp_traits"
	select BR2_PACKAGE_CPP_COMMON
	select BR2_PACKAGE_ROSTIME
	help
	  roscpp_traits contains the message traits code as described
	  in MessagesTraits.

	  https://wiki.ros.org/roscpp_traits
```

## package/ros/roscpp_core/rostime/Config.in
```kconfig
config BR2_PACKAGE_ROSTIME
	bool "rostime"
	select BR2_PACKAGE_CPP_COMMON
	select BR2_PACKAGE_BOOST_DATE_TIME
	help
	  Time and Duration implementations for C++ libraries.

	  https://wiki.ros.org/rostime
```

## package/ros/rospack/Config.in
```kconfig
config BR2_PACKAGE_ROSPACK
	bool "rospack"
	depends on BR2_PACKAGE_PYTHON3
	select BR2_PACKAGE_BOOST_FILESYSTEM
	select BR2_PACKAGE_BOOST_PROGRAM_OPTIONS
	select BR2_PACKAGE_CMAKE_MODULES
	select BR2_PACKAGE_PYTHON_ROSDEP # runtime
	select BR2_PACKAGE_ROS_ENVIRONMENT # runtime
	select BR2_PACKAGE_TINYXML2
	help
	  rospack is a command-line program which provides many of the
	  services of the *NIX pkg-config tool. It is used to find
	  packages among the "forest" of code in a typical ROS
	  distribution, calculate dependencies, mangle Makefiles, and
	  in general promote peace and harmony in a ROS distribution.

	  http://wiki.ros.org/rospack
```

## package/ros/std_msgs/Config.in
```kconfig
config BR2_PACKAGE_STD_MSGS
	bool "std_msgs"
	select BR2_PACKAGE_HOST_PYTHON_PYYAML
	select BR2_PACKAGE_MESSAGE_GENERATION
	select BR2_PACKAGE_MESSAGE_RUNTIME # runtime
	help
	  Standard ROS Messages including common message types
	  representing primitive data types and other basic message
	  constructs, such as multiarrays.

	  https://wiki.ros.org/std_msgs
```

## package/ros/unique_identifier/Config.in
```kconfig
menuconfig BR2_PACKAGE_UNIQUE_IDENTIFIER_SET
	bool "unique_identifier collection"

if BR2_PACKAGE_UNIQUE_IDENTIFIER_SET
source "package/ros/unique_identifier/unique_id/Config.in"
source "package/ros/unique_identifier/unique_identifier/Config.in"
source "package/ros/unique_identifier/uuid_msgs/Config.in"
endif
```

## package/ros/unique_identifier/unique_id/Config.in
```kconfig
config BR2_PACKAGE_UNIQUE_ID
	bool "unique_id"
	select BR2_PACKAGE_ROSCPP
	select BR2_PACKAGE_ROSPY
	select BR2_PACKAGE_ROS_COMM_SET
	select BR2_PACKAGE_UUID_MSGS
	help
	  This package provides Python and C++ interfaces for
	  universally unique identifiers (UUIDs), as described in RFC
	  4122.

	  https://wiki.ros.org/unique_id
```

## package/ros/unique_identifier/unique_identifier/Config.in
```kconfig
config BR2_PACKAGE_UNIQUE_IDENTIFIER
	bool "unique_identifier metapackage"
	select BR2_PACKAGE_UNIQUE_ID
	select BR2_PACKAGE_UUID_MSGS
	help
	  unique_identifier metapackage: ROS messages and interfaces
	  for universally unique identifiers.

	  This metapackage selects common packages for this
	  collection.

	  https://wiki.ros.org/unique_identifier
```

## package/ros/unique_identifier/uuid_msgs/Config.in
```kconfig
config BR2_PACKAGE_UUID_MSGS
	bool "uuid_msgs"
	select BR2_PACKAGE_MESSAGE_GENERATION
	select BR2_PACKAGE_MESSAGE_RUNTIME # runtime
	select BR2_PACKAGE_STD_MSGS
	help
	  ROS messages for universally unique identifiers.

	  http://wiki.ros.org/uuid_msgs
```

## package/ros/vision_opencv/Config.in
```kconfig
menuconfig BR2_PACKAGE_VISION_OPENCV_SET
	bool "vision_opencv collection"
	# We depends on opencv3 instead of selecting it to avoid a
	# recursive Kconfig dependency loop (involving python3, jack2,
	# fluidsynth, gstreamer1, opencv3, this package, numpy and
	# python3).
	depends on BR2_PACKAGE_OPENCV3

if BR2_PACKAGE_VISION_OPENCV_SET
source "package/ros/vision_opencv/cv_bridge/Config.in"
source "package/ros/vision_opencv/image_geometry/Config.in"
source "package/ros/vision_opencv/vision_opencv/Config.in"

comment "vision_opencv needs opencv3"
	depends on !BR2_PACKAGE_OPENCV3
endif
```

## package/ros/vision_opencv/cv_bridge/Config.in
```kconfig
config BR2_PACKAGE_CV_BRIDGE
	bool "cv_bridge"
	depends on BR2_PACKAGE_PYTHON_NUMPY_ARCH_SUPPORTS
	select BR2_PACKAGE_BOOST_PYTHON
	select BR2_PACKAGE_COMMON_MSGS_SET
	select BR2_PACKAGE_OPENCV3_LIB_IMGCODECS
	select BR2_PACKAGE_PYTHON_NUMPY
	select BR2_PACKAGE_ROSCONSOLE
	select BR2_PACKAGE_ROS_COMM_SET
	select BR2_PACKAGE_SENSOR_MSGS
	help
	  This contains CvBridge, which converts between ROS Image
	  messages and OpenCV images

	  http://wiki.ros.org/cv_bridge
```

## package/ros/vision_opencv/image_geometry/Config.in
```kconfig
config BR2_PACKAGE_IMAGE_GEOMETRY
	bool "image_geometry"
	select BR2_PACKAGE_COMMON_MSGS_SET
	select BR2_PACKAGE_OPENCV3_LIB_CALIB3D
	select BR2_PACKAGE_SENSOR_MSGS
	help
	  image_geometry contains C++ and Python libraries for
	  interpreting images geometrically. It interfaces the
	  calibration parameters in sensor_msgs/CameraInfo messages
	  with OpenCV functions such as image rectification, much as
	  cv_bridge interfaces ROS sensor_msgs/Image with OpenCV data
	  types.  This contains CvBridge, which converts between ROS
	  Image messages and OpenCV images

	  http://wiki.ros.org/image_geometry
```

## package/ros/vision_opencv/vision_opencv/Config.in
```kconfig
config BR2_PACKAGE_VISION_OPENCV
	bool "vision_opencv metapackage"
	select BR2_PACKAGE_CV_BRIDGE
	select BR2_PACKAGE_IMAGE_GEOMETRY
	help
	  Packages for interfacing ROS with OpenCV, a library of
	  programming functions for real time computer vision.

	  This metapackage selects common packages for this
	  collection.

	  http://wiki.ros.org/vision_opencv
```
