## package/ros/geometry/geometry/Config.in
```kconfig
config BR2_PACKAGE_GEOMETRY
	bool "geometry metapackage"
	select BR2_PACKAGE_ANGLES # runtime
	select BR2_PACKAGE_EIGEN_CONVERSIONS # runtime
	select BR2_PACKAGE_KDL_CONVERSIONS # runtime
	select BR2_PACKAGE_TF # runtime
	select BR2_PACKAGE_TF_CONVERSIONS # runtime
	help
	  A metapackage for geometry library suite.

	  This metapackage selects common packages for this
	  collection.

	  http://wiki.ros.org/geometry
```

## package/ros/geometry/kdl_conversions/Config.in
```kconfig
config BR2_PACKAGE_KDL_CONVERSIONS
	bool "kdl_conversions"
	select BR2_PACKAGE_GEOMETRY_MSGS
	select BR2_PACKAGE_OROCOS_KDL
	help
	  Conversion functions between KDL and geometry_msgs types.

	  http://wiki.ros.org/kdl_conversions
```

## package/ros/geometry/tf/Config.in
```kconfig
config BR2_PACKAGE_TF
	bool "tf"
	select BR2_PACKAGE_ANGLES
	select BR2_PACKAGE_COMMON_MSGS_SET
	select BR2_PACKAGE_GEOMETRY2_SET
	select BR2_PACKAGE_GEOMETRY_MSGS
	select BR2_PACKAGE_MESSAGE_FILTERS
	select BR2_PACKAGE_MESSAGE_GENERATION
	select BR2_PACKAGE_ROSCONSOLE
	select BR2_PACKAGE_ROSCPP
	select BR2_PACKAGE_ROSCPP_CORE_SET
	select BR2_PACKAGE_ROSTIME
	select BR2_PACKAGE_ROS_COMM_SET
	select BR2_PACKAGE_SENSOR_MSGS
	select BR2_PACKAGE_STD_MSGS
	select BR2_PACKAGE_TF2_ROS
	help
	  tf is a package that lets the user keep track of multiple
	  coordinate frames over time. tf maintains the relationship
	  between coordinate frames in a tree structure buffered in
	  time, and lets the user transform points, vectors, etc
	  between any two coordinate frames at any desired point in
	  time.

	  http://wiki.ros.org/tf
```

## package/ros/geometry/tf_conversions/Config.in
```kconfig
config BR2_PACKAGE_TF_CONVERSIONS
	bool "tf_conversions"
	select BR2_PACKAGE_CMAKE_MODULES
	select BR2_PACKAGE_COMMON_MSGS_SET
	select BR2_PACKAGE_GEOMETRY_MSGS
	select BR2_PACKAGE_OROCOS_KDL
	help
	  This package contains a set of conversion functions to
	  convert common tf datatypes (point, vector, pose, etc) into
	  semantically identical datatypes used by other
	  libraries. The conversion functions make it easier for users
	  of the transform library (tf) to work with the datatype of
	  their choice. Currently this package has support for the
	  Kinematics and Dynamics Library (KDL) and the Eigen matrix
	  library.

	  http://wiki.ros.org/tf_conversions
```

## package/ros/geometry2/Config.in
```kconfig
menuconfig BR2_PACKAGE_GEOMETRY2_SET
	bool "geometry2 collection"

if BR2_PACKAGE_GEOMETRY2_SET
source "package/ros/geometry2/geometry2/Config.in"
source "package/ros/geometry2/tf2/Config.in"
source "package/ros/geometry2/tf2_eigen/Config.in"
source "package/ros/geometry2/tf2_geometry_msgs/Config.in"
source "package/ros/geometry2/tf2_kdl/Config.in"
source "package/ros/geometry2/tf2_msgs/Config.in"
source "package/ros/geometry2/tf2_py/Config.in"
source "package/ros/geometry2/tf2_ros/Config.in"
source "package/ros/geometry2/tf2_sensor_msgs/Config.in"
source "package/ros/geometry2/tf2_tools/Config.in"
endif
```

## package/ros/geometry2/geometry2/Config.in
```kconfig
config BR2_PACKAGE_GEOMETRY2
	bool "geometry2 metapackage"
	select BR2_PACKAGE_TF2 # runtime
	#select BR2_PACKAGE_TF2_BULLET
	select BR2_PACKAGE_TF2_EIGEN # runtime
	select BR2_PACKAGE_TF2_GEOMETRY_MSGS # runtime
	select BR2_PACKAGE_TF2_KDL # runtime
	select BR2_PACKAGE_TF2_MSGS # runtime
	select BR2_PACKAGE_TF2_PY # runtime
	select BR2_PACKAGE_TF2_ROS # runtime
	select BR2_PACKAGE_TF2_SENSOR_MSGS # runtime
	select BR2_PACKAGE_TF2_TOOLS # runtime
	help
	  A metapackage to bring in the default packages second
	  generation Transform Library in ros, tf2.

	  This metapackage selects common packages for this
	  collection.

	  http://wiki.ros.org/geometry2
```

## package/ros/geometry2/tf2/Config.in
```kconfig
config BR2_PACKAGE_TF2
	bool "tf2"
	select BR2_PACKAGE_BOOST_SYSTEM
	select BR2_PACKAGE_BOOST_THREAD
	select BR2_PACKAGE_COMMON_MSGS_SET
	select BR2_PACKAGE_CONSOLE_BRIDGE
	select BR2_PACKAGE_GEOMETRY_MSGS
	select BR2_PACKAGE_GTEST
	select BR2_PACKAGE_ROSCPP_CORE_SET
	select BR2_PACKAGE_ROSTIME
	select BR2_PACKAGE_TF2_MSGS
	help
	  tf2 is the second generation of the transform library, which
	  lets the user keep track of multiple coordinate frames over
	  time. tf2 maintains the relationship between coordinate
	  frames in a tree structure buffered in time, and lets the
	  user transform points, vectors, etc between any two
	  coordinate frames at any desired point in time.

	  http://wiki.ros.org/tf2
```

## package/ros/geometry2/tf2_eigen/Config.in
```kconfig
config BR2_PACKAGE_TF2_EIGEN
	bool "tf2_eigen"
	help
	  This is a conversion package to convert tf2 data to eigen
	  data structures.

	  http://wiki.ros.org/tf2_eigen
```

## package/ros/geometry2/tf2_geometry_msgs/Config.in
```kconfig
config BR2_PACKAGE_TF2_GEOMETRY_MSGS
	bool "tf2_geometry_msgs"
	select BR2_PACKAGE_EIGEN
	select BR2_PACKAGE_OROCOS_KDL
	select BR2_PACKAGE_TF2_ROS
	help
	  This package allows to convert ros messages to tf2 messages
	  and to retrieve data from ros messages.

	  http://wiki.ros.org/tf2_geometry_msgs
```

## package/ros/geometry2/tf2_kdl/Config.in
```kconfig
config BR2_PACKAGE_TF2_KDL
	bool "tf2_kdl"
	select BR2_PACKAGE_EIGEN
	select BR2_PACKAGE_TF2_ROS
	help
	  This is a conversion package to convert tf2 data to KDL data
	  structures.

	  http://wiki.ros.org/tf2_kdl
```

## package/ros/geometry2/tf2_msgs/Config.in
```kconfig
config BR2_PACKAGE_TF2_MSGS
	bool "tf2_msgs"
	select BR2_PACKAGE_ACTIONLIB_MSGS
	select BR2_PACKAGE_BOOST_THREAD
	select BR2_PACKAGE_COMMON_MSGS_SET
	select BR2_PACKAGE_GEOMETRY_MSGS
	select BR2_PACKAGE_MESSAGE_GENERATION
	help
	  This is the package grouping the Transform and Error
	  messages used by tf2 and tf2_ros.

	  http://wiki.ros.org/tf2_msgs
```

## package/ros/geometry2/tf2_py/Config.in
```kconfig
config BR2_PACKAGE_TF2_PY
	bool "tf2_py"
	select BR2_PACKAGE_ROSPY
	select BR2_PACKAGE_ROS_COMM_SET
	select BR2_PACKAGE_TF2
	help
	  This package allows to convert tf2 and geometry_msgs data to
	  PyObjects. Also binds the tf2 functions and exceptions to
	  python.

	  http://wiki.ros.org/tf2_py
```

## package/ros/geometry2/tf2_sensor_msgs/Config.in
```kconfig
config BR2_PACKAGE_TF2_SENSOR_MSGS
	bool "tf2_sensor_msgs"
	select BR2_PACKAGE_BOOST_THREAD
	select BR2_PACKAGE_CMAKE_MODULES
	select BR2_PACKAGE_COMMON_MSGS_SET
	select BR2_PACKAGE_EIGEN
	select BR2_PACKAGE_SENSOR_MSGS
	select BR2_PACKAGE_TF2_ROS
	help
	  Small lib to transform sensor_msgs with tf.

	  http://wiki.ros.org/tf2_sensor_msgs
```

## package/ros/geometry2/tf2_tools/Config.in
```kconfig
config BR2_PACKAGE_TF2_TOOLS
	bool "tf2_tools"
	select BR2_PACKAGE_TF2_ROS
	help
	  tf2_tools

	  http://wiki.ros.org/tf2_tools
```

## package/ros/image_common/Config.in
```kconfig
menuconfig BR2_PACKAGE_IMAGE_COMMON_SET
	bool "image_common collection"

if BR2_PACKAGE_IMAGE_COMMON_SET
source "package/ros/image_common/camera_calibration_parsers/Config.in"
source "package/ros/image_common/camera_info_manager/Config.in"
source "package/ros/image_common/image_common/Config.in"
source "package/ros/image_common/image_transport/Config.in"
source "package/ros/image_common/polled_camera/Config.in"
endif
```

## package/ros/image_common/camera_calibration_parsers/Config.in
```kconfig
config BR2_PACKAGE_CAMERA_CALIBRATION_PARSERS
	bool "camera_calibration_parsers"
	select BR2_PACKAGE_BOOST_FILESYSTEM
	select BR2_PACKAGE_BOOST_PYTHON
	select BR2_PACKAGE_COMMON_MSGS_SET
	select BR2_PACKAGE_ROSCONSOLE
	select BR2_PACKAGE_ROSCPP
	select BR2_PACKAGE_ROSCPP_CORE_SET
	select BR2_PACKAGE_ROSCPP_SERIALIZATION
	select BR2_PACKAGE_ROS_COMM_SET
	select BR2_PACKAGE_SENSOR_MSGS
	select BR2_PACKAGE_YAML_CPP
	help
	  camera_calibration_parsers contains routines for reading and
	  writing camera calibration parameters.

	  http://wiki.ros.org/camera_calibration_parsers
```

## package/ros/image_common/camera_info_manager/Config.in
```kconfig
config BR2_PACKAGE_CAMERA_INFO_MANAGER
	bool "camera_info_manager"
	select BR2_PACKAGE_CAMERA_CALIBRATION_PARSERS
	select BR2_PACKAGE_COMMON_MSGS_SET
	select BR2_PACKAGE_IMAGE_TRANSPORT
	select BR2_PACKAGE_ROSCPP
	select BR2_PACKAGE_ROS_COMM_SET
	select BR2_PACKAGE_ROS_ROSLIB
	select BR2_PACKAGE_ROS_SET
	select BR2_PACKAGE_SENSOR_MSGS
	help
	  This package provides a C++ interface for camera calibration
	  information. It provides CameraInfo, and handles
	  SetCameraInfo service requests, saving and restoring the
	  camera calibration data.

	  http://wiki.ros.org/camera_info_manager
```

## package/ros/image_common/image_common/Config.in
```kconfig
config BR2_PACKAGE_IMAGE_COMMON
	bool "image_common metapackage"
	select BR2_PACKAGE_CAMERA_CALIBRATION_PARSERS
	select BR2_PACKAGE_CAMERA_INFO_MANAGER
	select BR2_PACKAGE_IMAGE_TRANSPORT
	select BR2_PACKAGE_POLLED_CAMERA
	help
	  image_common metapackage: common code for working with
	  images in ROS.

	  This metapackage selects common packages for this
	  collection.

	  http://wiki.ros.org/image_common
```

## package/ros/image_common/image_transport/Config.in
```kconfig
config BR2_PACKAGE_IMAGE_TRANSPORT
	bool "image_transport"
	select BR2_PACKAGE_CMAKE_MODULES
	select BR2_PACKAGE_COMMON_MSGS_SET
	select BR2_PACKAGE_MESSAGE_FILTERS
	select BR2_PACKAGE_PLUGINLIB
	select BR2_PACKAGE_ROSCONSOLE
	select BR2_PACKAGE_ROSCPP
	select BR2_PACKAGE_ROSLIB
	select BR2_PACKAGE_ROS_COMM_SET
	select BR2_PACKAGE_ROS_SET
	select BR2_PACKAGE_SENSOR_MSGS
	help
	  image_transport should always be used to subscribe to and
	  publish images. It provides transparent support for
	  transporting images in low-bandwidth compressed
	  formats. Examples (provided by separate plugin packages)
	  include JPEG/PNG compression and Theora streaming video.

	  http://wiki.ros.org/image_transport
```

## package/ros/image_common/polled_camera/Config.in
```kconfig
config BR2_PACKAGE_POLLED_CAMERA
	bool "polled_camera"
	select BR2_PACKAGE_COMMON_MSGS_SET
	select BR2_PACKAGE_IMAGE_TRANSPORT
	select BR2_PACKAGE_MESSAGE_GENERATION
	select BR2_PACKAGE_MESSAGE_RUNTIME
	select BR2_PACKAGE_ROSCPP
	select BR2_PACKAGE_STD_MSGS
	select BR2_PACKAGE_ROS_COMM_SET
	select BR2_PACKAGE_SENSOR_MSGS
	help
	  polled_camera contains a service and C++ helper classes for
	  implementing a polled camera driver node and requesting
	  images from it. The package is currently for internal use as
	  the API is still under development.

	  http://wiki.ros.org/polled_camera
```

## package/ros/mavlink/Config.in
```kconfig
config BR2_PACKAGE_MAVLINK
	bool "mavlink"
	#depends on BR2_PACKAGE_BOOST
	help
	  MAVLink message marshaling library. This package provides
	  C-headers and C++11 library for both 1.0 and 2.0 versions of
	  protocol.

	  http://wiki.ros.org/mavlink
```

## package/ros/mavros/Config.in
```kconfig
menuconfig BR2_PACKAGE_MAVROS_SET
	bool "mavros collection"

if BR2_PACKAGE_MAVROS_SET
source "package/ros/mavros/libmavconn/Config.in"
source "package/ros/mavros/mavros/Config.in"
source "package/ros/mavros/mavros_extras/Config.in"
source "package/ros/mavros/mavros_msgs/Config.in"
endif
```

## package/ros/mavros/libmavconn/Config.in
```kconfig
config BR2_PACKAGE_LIBMAVCONN
	bool "libmavconn"
	help
	  MAVLink communication library. This library provide unified
	  connection handling classes and URL to connection object
	  mapper. This library can be used in standalone programs.
```

## package/ros/mavros/mavros/Config.in
```kconfig
config BR2_PACKAGE_MAVROS
	bool "mavros"
	select BR2_PACKAGE_ANGLES
	select BR2_PACKAGE_CMAKE_MODULES
	select BR2_PACKAGE_COMMON_MSGS_SET
	select BR2_PACKAGE_DIAGNOSTICS_SET
	select BR2_PACKAGE_DIAGNOSTIC_MSGS
	select BR2_PACKAGE_DIAGNOSTIC_UPDATER
	select BR2_PACKAGE_EIGEN_CONVERSIONS
	select BR2_PACKAGE_GEOGRAPHICLIB
	select BR2_PACKAGE_GEOGRAPHICLIB_GEOIDS
	select BR2_PACKAGE_GEOGRAPHICLIB_GEOIDS_EGM96_5
	select BR2_PACKAGE_GEOGRAPHIC_INFO_SET
	select BR2_PACKAGE_GEOGRAPHIC_MSGS
	select BR2_PACKAGE_GEOMETRY2_SET
	select BR2_PACKAGE_GEOMETRY_SET
	select BR2_PACKAGE_LIBMAVCONN
	select BR2_PACKAGE_MAVLINK
	select BR2_PACKAGE_MAVROS_MSGS
	select BR2_PACKAGE_NAV_MSGS
	select BR2_PACKAGE_PLUGINLIB
	select BR2_PACKAGE_ROSCONSOLE_BRIDGE
	select BR2_PACKAGE_ROSCPP
	select BR2_PACKAGE_ROSPY
	select BR2_PACKAGE_ROS_COMM_SET
	select BR2_PACKAGE_SENSOR_MSGS
	select BR2_PACKAGE_STD_MSGS
	select BR2_PACKAGE_STD_SRVS
	select BR2_PACKAGE_TF2_EIGEN
	select BR2_PACKAGE_TF2_ROS
	select BR2_PACKAGE_TRAJECTORY_MSGS
	help
	  MAVROS -- MAVLink extendable communication node for ROS with
	  proxy for Ground Control Station.

	  http://wiki.ros.org/mavros
```
