## configs/octave_defconfig
```kconfig
BR2_aarch64=y
BR2_ARM_FPU_VFPV3=y
BR2_CCACHE=y
BR2_TOOLCHAIN_EXTERNAL=y
BR2_TARGET_GENERIC_GETTY_PORT="ttyAMA0"
BR2_SYSTEM_DHCP="eth0"
BR2_ROOTFS_POST_IMAGE_SCRIPT="board/qemu/post-image.sh"
BR2_ROOTFS_POST_SCRIPT_ARGS="qemu_aarch64_virt_defconfig"
BR2_LINUX_KERNEL=y
BR2_LINUX_KERNEL_CUSTOM_VERSION=y
BR2_LINUX_KERNEL_CUSTOM_VERSION_VALUE="5.15.52"
BR2_LINUX_KERNEL_USE_CUSTOM_CONFIG=y
BR2_LINUX_KERNEL_CUSTOM_CONFIG_FILE="board/qemu/aarch64-virt/linux.config"
BR2_LINUX_KERNEL_NEEDS_HOST_OPENSSL=y
BR2_PACKAGE_OCTAVE_CONTROL=y
BR2_TARGET_ROOTFS_EXT2=y
BR2_TARGET_ROOTFS_EXT2_4=y
BR2_TARGET_ROOTFS_EXT2_SIZE="250M"
# BR2_TARGET_ROOTFS_TAR is not set
```

## configs/ros_imx8mmevk_defconfig
```kconfig
BR2_aarch64=y
BR2_ARM_FPU_VFPV3=y
BR2_CCACHE=y
BR2_TOOLCHAIN_EXTERNAL=y
BR2_TARGET_GENERIC_GETTY_PORT="ttymxc1"
BR2_ROOTFS_POST_IMAGE_SCRIPT="board/freescale/common/imx/imx8-bootloader-prepare.sh board/freescale/common/imx/post-image.sh"
BR2_ROOTFS_POST_SCRIPT_ARGS="${UBOOT_DIR}/arch/arm/dts/imx8mm-evk.dtb"
BR2_LINUX_KERNEL=y
BR2_LINUX_KERNEL_CUSTOM_GIT=y
BR2_LINUX_KERNEL_CUSTOM_REPO_URL="https://source.codeaurora.org/external/imx/linux-imx"
BR2_LINUX_KERNEL_CUSTOM_REPO_VERSION="lf-5.10.y-1.0.0"
BR2_LINUX_KERNEL_DEFCONFIG="imx_v8"
BR2_LINUX_KERNEL_DTS_SUPPORT=y
BR2_LINUX_KERNEL_INTREE_DTS_NAME="freescale/imx8mm-evk freescale/imx8mm-evk-revb-qca-wifi"
BR2_LINUX_KERNEL_NEEDS_HOST_OPENSSL=y
BR2_PACKAGE_FREESCALE_IMX=y
BR2_PACKAGE_FREESCALE_IMX_PLATFORM_IMX8MM=y
BR2_PACKAGE_FIRMWARE_IMX=y
BR2_PACKAGE_OPENCV3=y
BR2_PACKAGE_ROS_SUPPORT=y
BR2_PACKAGE_BOND_CORE=y
BR2_PACKAGE_COMMON_MSGS=y
BR2_PACKAGE_DIAGNOSTICS=y
BR2_PACKAGE_ROSDIAGNOSTIC=y
BR2_PACKAGE_GEOMETRY=y
BR2_PACKAGE_GEOMETRY2=y
BR2_PACKAGE_IMAGE_COMMON_SET=y
BR2_PACKAGE_IMAGE_COMMON=y
BR2_PACKAGE_MAVROS_SET=y
BR2_PACKAGE_MAVROS=y
BR2_PACKAGE_MAVROS_EXTRAS=y
BR2_PACKAGE_NODELET_CORE_SET=y
BR2_PACKAGE_NODELET_CORE=y
BR2_PACKAGE_ROS_COMM=y
BR2_PACKAGE_ROS_ENVIRONMENT_INSTALL_PROFILE=y
BR2_PACKAGE_ROS_TUTORIALS_SET=y
BR2_PACKAGE_ROSCPP_TUTORIALS=y
BR2_PACKAGE_ROSPY_TUTORIALS=y
BR2_PACKAGE_ROSCPP_CORE=y
BR2_PACKAGE_VISION_OPENCV_SET=y
BR2_PACKAGE_VISION_OPENCV=y
BR2_TARGET_ROOTFS_EXT2=y
BR2_TARGET_ROOTFS_EXT2_4=y
BR2_TARGET_ROOTFS_EXT2_SIZE="220M"
BR2_TARGET_ARM_TRUSTED_FIRMWARE=y
BR2_TARGET_ARM_TRUSTED_FIRMWARE_CUSTOM_GIT=y
BR2_TARGET_ARM_TRUSTED_FIRMWARE_CUSTOM_REPO_URL="https://source.codeaurora.org/external/imx/imx-atf"
BR2_TARGET_ARM_TRUSTED_FIRMWARE_CUSTOM_REPO_VERSION="lf-5.10.y-1.0.0"
BR2_TARGET_ARM_TRUSTED_FIRMWARE_PLATFORM="imx8mm"
BR2_TARGET_ARM_TRUSTED_FIRMWARE_BL31=y
BR2_TARGET_UBOOT=y
BR2_TARGET_UBOOT_BUILD_SYSTEM_KCONFIG=y
BR2_TARGET_UBOOT_CUSTOM_GIT=y
BR2_TARGET_UBOOT_CUSTOM_REPO_URL="https://source.codeaurora.org/external/imx/uboot-imx"
BR2_TARGET_UBOOT_CUSTOM_REPO_VERSION="lf-5.10.y-1.0.0"
BR2_TARGET_UBOOT_BOARD_DEFCONFIG="imx8mm_evk"
BR2_TARGET_UBOOT_NEEDS_DTC=y
BR2_TARGET_UBOOT_FORMAT_CUSTOM=y
BR2_TARGET_UBOOT_FORMAT_CUSTOM_NAME="u-boot-nodtb.bin"
BR2_TARGET_UBOOT_SPL=y
BR2_PACKAGE_HOST_DOSFSTOOLS=y
BR2_PACKAGE_HOST_GENIMAGE=y
BR2_PACKAGE_HOST_IMX_MKIMAGE=y
BR2_PACKAGE_HOST_MTOOLS=y
BR2_PACKAGE_HOST_UBOOT_TOOLS=y
BR2_PACKAGE_HOST_UBOOT_TOOLS_FIT_SUPPORT=y
```

## configs/ros_rv64_defconfig
```kconfig
BR2_riscv=y
BR2_TOOLCHAIN_BUILDROOT_GLIBC=y
BR2_PACKAGE_HOST_LINUX_HEADERS_CUSTOM_5_4=y
BR2_TOOLCHAIN_BUILDROOT_CXX=y
BR2_SYSTEM_DHCP="eth0"
BR2_ROOTFS_POST_IMAGE_SCRIPT="board/qemu/post-image.sh"
BR2_ROOTFS_POST_SCRIPT_ARGS="qemu_riscv64_virt_defconfig"
BR2_LINUX_KERNEL=y
BR2_LINUX_KERNEL_CUSTOM_VERSION=y
BR2_LINUX_KERNEL_CUSTOM_VERSION_VALUE="5.4.42"
BR2_LINUX_KERNEL_USE_ARCH_DEFAULT_CONFIG=y
BR2_PACKAGE_PYTHON3_BZIP2=y
BR2_PACKAGE_BOOST_CONTAINER=y
BR2_PACKAGE_BOOST_CONTRACT=y
BR2_PACKAGE_BOOST_EXCEPTION=y
BR2_PACKAGE_BOOST_GRAPH=y
BR2_PACKAGE_BOOST_GRAPH_PARALLEL=y
BR2_PACKAGE_BOOST_IOSTREAMS=y
BR2_PACKAGE_BOOST_LOCALE=y
BR2_PACKAGE_BOOST_LOG=y
BR2_PACKAGE_BOOST_MATH=y
BR2_PACKAGE_BOOST_MPI=y
BR2_PACKAGE_BOOST_RANDOM=y
BR2_PACKAGE_BOOST_SERIALIZATION=y
BR2_PACKAGE_BOOST_STACKTRACE=y
BR2_PACKAGE_BOOST_TEST=y
BR2_PACKAGE_BOOST_TYPE_ERASURE=y
BR2_PACKAGE_BOOST_WAVE=y
BR2_PACKAGE_GEOGRAPHICLIB_GRAVITY=y
BR2_PACKAGE_GEOGRAPHICLIB_MAGNETIC=y
BR2_PACKAGE_ROS_SUPPORT=y
BR2_PACKAGE_BOND_CORE=y
BR2_PACKAGE_TEST_BOND=y
BR2_PACKAGE_COMMON_MSGS=y
BR2_PACKAGE_DIAGNOSTICS=y
BR2_PACKAGE_ROSDIAGNOSTIC=y
BR2_PACKAGE_GEOMETRY=y
BR2_PACKAGE_GEOMETRY2=y
BR2_PACKAGE_IMAGE_COMMON_SET=y
BR2_PACKAGE_IMAGE_COMMON=y
BR2_PACKAGE_MAVROS_SET=y
BR2_PACKAGE_MAVROS=y
BR2_PACKAGE_MAVROS_EXTRAS=y
BR2_PACKAGE_NODELET_CORE_SET=y
BR2_PACKAGE_NODELET_CORE=y
BR2_PACKAGE_ROS_COMM=y
BR2_PACKAGE_ROS_ENVIRONMENT_INSTALL_PROFILE=y
BR2_PACKAGE_ROS_TUTORIALS_SET=y
BR2_PACKAGE_ROSCPP_TUTORIALS=y
BR2_PACKAGE_ROSPY_TUTORIALS=y
BR2_PACKAGE_ROSCPP_CORE=y
BR2_PACKAGE_UNIQUE_IDENTIFIER=y
BR2_TARGET_ROOTFS_EXT2=y
BR2_TARGET_ROOTFS_EXT2_4=y
BR2_TARGET_ROOTFS_EXT2_SIZE="200M"
# BR2_TARGET_ROOTFS_TAR is not set
BR2_TARGET_OPENSBI=y
BR2_TARGET_OPENSBI_PLAT="generic"
BR2_PACKAGE_HOST_PYTHON=y
```

## configs/sc19_qemu_aarch64_defconfig
```kconfig
BR2_aarch64=y
BR2_CCACHE=y
BR2_OPTIMIZE_2=y
BR2_TOOLCHAIN_EXTERNAL=y
BR2_ROOTFS_DEVICE_CREATION_DYNAMIC_EUDEV=y
BR2_TARGET_GENERIC_GETTY_PORT="ttyAMA0"
BR2_SYSTEM_DHCP="eth0"
BR2_ROOTFS_OVERLAY="sc19-rootfs-overlay"
BR2_LINUX_KERNEL=y
BR2_LINUX_KERNEL_USE_ARCH_DEFAULT_CONFIG=y
BR2_LINUX_KERNEL_CONFIG_FRAGMENT_FILES="board/qemu/aarch64-virt/drm-virtio-gpu.fragment"
BR2_LINUX_KERNEL_NEEDS_HOST_OPENSSL=y
BR2_PACKAGE_GLSLSANDBOX_PLAYER=y
BR2_PACKAGE_GLSLSANDBOX_PLAYER_PNG=y
BR2_PACKAGE_MESA3D=y
BR2_PACKAGE_MESA3D_GALLIUM_DRIVER_VIRGL=y
BR2_PACKAGE_MESA3D_OPENGL_ES=y
BR2_PACKAGE_LIBDRM_INSTALL_TESTS=y
BR2_TARGET_ROOTFS_EXT2=y
BR2_TARGET_ROOTFS_EXT2_SIZE="120M"
# BR2_TARGET_ROOTFS_TAR is not set
```

## configs/sc19_rpi3_defconfig
```kconfig
BR2_arm=y
BR2_cortex_a53=y
BR2_ARM_FPU_NEON_VFPV4=y
BR2_CCACHE=y
BR2_OPTIMIZE_2=y
BR2_TOOLCHAIN_EXTERNAL=y
BR2_SYSTEM_BIN_SH_BASH=y
BR2_SYSTEM_DHCP="eth0"
BR2_ROOTFS_OVERLAY="sc19-rootfs-overlay"
BR2_ROOTFS_POST_BUILD_SCRIPT="board/raspberrypi3/post-build.sh"
BR2_ROOTFS_POST_IMAGE_SCRIPT="board/raspberrypi3/post-image.sh"
BR2_ROOTFS_POST_SCRIPT_ARGS="--add-pi3-miniuart-bt-overlay"
BR2_LINUX_KERNEL=y
BR2_LINUX_KERNEL_CUSTOM_TARBALL=y
BR2_LINUX_KERNEL_CUSTOM_TARBALL_LOCATION="$(call github,raspberrypi,linux,5eeff139ea9135db6e01a58ef613338f1d0899d8)/linux-5eeff139ea9135db6e01a58ef613338f1d0899d8.tar.gz"
BR2_LINUX_KERNEL_DEFCONFIG="bcm2709"
BR2_LINUX_KERNEL_DTS_SUPPORT=y
BR2_LINUX_KERNEL_INTREE_DTS_NAME="bcm2710-rpi-3-b bcm2710-rpi-3-b-plus bcm2710-rpi-cm3"
BR2_LINUX_KERNEL_NEEDS_HOST_OPENSSL=y
BR2_PACKAGE_BUSYBOX_SHOW_OTHERS=y
BR2_PACKAGE_GSTREAMER1=y
BR2_PACKAGE_GST1_PLUGINS_BASE_PLUGIN_VIDEOCONVERT=y
BR2_PACKAGE_GST1_PLUGINS_BASE_PLUGIN_VIDEOTESTSRC=y
BR2_PACKAGE_GST1_PLUGINS_BASE_LIB_OPENGL=y
BR2_PACKAGE_GST1_PLUGINS_GOOD=y
BR2_PACKAGE_GST1_PLUGINS_GOOD_PLUGIN_VIDEOFILTER=y
BR2_PACKAGE_GST1_PLUGINS_GOOD_PLUGIN_V4L2=y
BR2_PACKAGE_GST1_PLUGINS_BAD=y
BR2_PACKAGE_GLSLSANDBOX_PLAYER=y
BR2_PACKAGE_GLSLSANDBOX_PLAYER_PNG=y
BR2_PACKAGE_RPI_FIRMWARE=y
BR2_PACKAGE_RPI_USERLAND=y
BR2_TARGET_ROOTFS_EXT2=y
BR2_TARGET_ROOTFS_EXT2_4=y
BR2_TARGET_ROOTFS_EXT2_SIZE="120M"
# BR2_TARGET_ROOTFS_TAR is not set
BR2_PACKAGE_HOST_DOSFSTOOLS=y
BR2_PACKAGE_HOST_GENIMAGE=y
BR2_PACKAGE_HOST_MTOOLS=y
```

## configs/sc19_wandboardqp_defconfig
```kconfig
BR2_arm=y
BR2_cortex_a9=y
BR2_ARM_ENABLE_NEON=y
BR2_ARM_ENABLE_VFP=y
BR2_ARM_FPU_VFPV3=y
BR2_TOOLCHAIN_EXTERNAL=y
BR2_ROOTFS_DEVICE_CREATION_DYNAMIC_EUDEV=y
BR2_TARGET_GENERIC_GETTY_PORT="ttymxc0"
BR2_ROOTFS_OVERLAY="sc19-rootfs-overlay"
BR2_ROOTFS_POST_BUILD_SCRIPT="board/wandboard/post-build.sh"
BR2_ROOTFS_POST_IMAGE_SCRIPT="board/wandboard/post-image.sh"
BR2_LINUX_KERNEL=y
BR2_LINUX_KERNEL_DEFCONFIG="imx_v6_v7"
BR2_LINUX_KERNEL_DTS_SUPPORT=y
BR2_LINUX_KERNEL_INTREE_DTS_NAME="imx6q-wandboard imx6dl-wandboard imx6q-wandboard-revb1 imx6dl-wandboard-revb1 imx6q-wandboard-revd1 imx6dl-wandboard-revd1 imx6qp-wandboard-revd1"
BR2_LINUX_KERNEL_INSTALL_TARGET=y
BR2_LINUX_KERNEL_NEEDS_HOST_OPENSSL=y
BR2_PACKAGE_STRACE=y
BR2_PACKAGE_GLSLSANDBOX_PLAYER=y
BR2_PACKAGE_GLSLSANDBOX_PLAYER_DL_SHADERS=y
BR2_PACKAGE_GLSLSANDBOX_PLAYER_PNG=y
BR2_PACKAGE_KMSCUBE=y
BR2_PACKAGE_MESA3D=y
BR2_PACKAGE_MESA3D_GALLIUM_DRIVER_ETNAVIV=y
BR2_PACKAGE_MESA3D_GALLIUM_DRIVER_KMSRO=y
BR2_PACKAGE_MESA3D_GALLIUM_DRIVER_VC4=y
BR2_PACKAGE_MESA3D_OPENGL_ES=y
BR2_PACKAGE_LIBDRM_INSTALL_TESTS=y
BR2_TARGET_ROOTFS_EXT2=y
BR2_TARGET_ROOTFS_EXT2_4=y
BR2_TARGET_UBOOT=y
BR2_TARGET_UBOOT_BOARD_DEFCONFIG="wandboard"
BR2_TARGET_UBOOT_FORMAT_IMG=y
BR2_TARGET_UBOOT_SPL=y
BR2_TARGET_UBOOT_SPL_NAME="SPL"
BR2_PACKAGE_HOST_DOSFSTOOLS=y
BR2_PACKAGE_HOST_GENIMAGE=y
BR2_PACKAGE_HOST_MTOOLS=y
BR2_PACKAGE_HOST_UBOOT_TOOLS=y
```

## package/dpdk/Config.in
```kconfig
config BR2_PACKAGE_DPDK_ARCH_SUPPORTS
	bool
	# DPDK can be used for the following little endian architecture
	default y if BR2_RISCV_64
	default y if BR2_aarch64
	default y if BR2_powerpc64le
	# DPDK requires SSE4.2 for x86_64 since v17.08
	default y if BR2_x86_64 && BR2_X86_CPU_HAS_SSE42

config BR2_PACKAGE_DPDK
	bool "dpdk"
	depends on BR2_PACKAGE_DPDK_ARCH_SUPPORTS
	depends on BR2_TOOLCHAIN_HAS_THREADS # DPDK design
	depends on BR2_USE_MMU # pthread() memory mappings
	depends on BR2_TOOLCHAIN_GCC_AT_LEAST_4_9 # C11/stdatomic.h
	depends on BR2_TOOLCHAIN_HEADERS_AT_LEAST_4_19
	depends on BR2_TOOLCHAIN_USES_GLIBC
	select BR2_PACKAGE_LIBEXECINFO if !BR2_TOOLCHAIN_USES_GLIBC
	help
	  DPDK (Data Plane Development Kit) is a set of libraries
	  and drivers for fast packet processing.

	  http://dpdk.org/

comment "DPDK needs a toolchain w/ dynamic library, threads, wchar, kernel headers >= 4.19"
	depends on BR2_USE_MMU # pthread() memory mappings
	depends on BR2_PACKAGE_DPDK_ARCH_SUPPORTS
	depends on BR2_TOOLCHAIN_GCC_AT_LEAST_4_9 # C11/stdatomic.h
	depends on BR2_TOOLCHAIN_HEADERS_AT_LEAST_4_19
	depends on !BR2_TOOLCHAIN_HAS_THREADS || \
		!BR2_TOOLCHAIN_USES_GLIBC || \
		!BR2_TOOLCHAIN_GCC_AT_LEAST_4_9 || \
		!BR2_TOOLCHAIN_HEADERS_AT_LEAST_4_19
```

## package/geographiclib/Config.in
```kconfig
config BR2_PACKAGE_GEOGRAPHICLIB
	bool "geographiclib"
	help
	  GeographicLib is a small set of C++ classes for performing
	  conversions between geographic, UTM, UPS, MGRS, geocentric,
	  and local cartesian coordinates, for gravity (e.g.,
	  EGM2008), geoid height, and geomagnetic field (e.g.,
	  WMM2020) calculations, and for solving geodesic
	  problems. (The library may be used from .NET applications
	  using the NETGeographicLib wrapper library.) It is a
	  suitable replacement for the core functionality provided by
	  geotrans. The library is licensed under the MIT/X11 License;
	  see LICENSE.txt for the terms.

	  https://geographiclib.sourceforge.io/

if BR2_PACKAGE_GEOGRAPHICLIB

config BR2_PACKAGE_GEOGRAPHICLIB_GEOIDS
	bool "Install gridded geoid data"

if BR2_PACKAGE_GEOGRAPHICLIB_GEOIDS
config BR2_PACKAGE_GEOGRAPHICLIB_GEOIDS_EGM96_5
	bool "geoids egm96-5"
	default y
endif

config BR2_PACKAGE_GEOGRAPHICLIB_GRAVITY
	bool "Install earth gravity models"

if BR2_PACKAGE_GEOGRAPHICLIB_GRAVITY
config BR2_PACKAGE_GEOGRAPHICLIB_GRAVITY_EGM96
	bool "gravity egm96"
	default y
endif

config BR2_PACKAGE_GEOGRAPHICLIB_MAGNETIC
	bool "Install geomagnetic  models"

if BR2_PACKAGE_GEOGRAPHICLIB_MAGNETIC
config BR2_PACKAGE_GEOGRAPHICLIB_MAGNETIC_EMM2015
	bool "magnetic emm2015"
	default y
endif

endif
```

## package/glslsandbox-player/Config.in
```kconfig
config BR2_PACKAGE_GLSLSANDBOX_PLAYER
	bool "glslsandbox-player"
	depends on BR2_PACKAGE_HAS_LIBEGL
	depends on BR2_PACKAGE_HAS_LIBGLES
	help
	  GLSL Sandbox standalone player allow one to run and render
	  (most of) nice shaders available online on the
	  http://glslsandbox.com/ website, but without the need of an
	  Internet connection, a web browser or any of its
	  dependencies. Instead, the only requirement of
	  glslsandbox-player is a working EGL and GLESv2 libraries.

	  This package is useful for stressing and testing GLES shader
	  compiler in GPU drivers.

	  https://github.com/jolivain/glslsandbox-player

if BR2_PACKAGE_GLSLSANDBOX_PLAYER

config BR2_PACKAGE_GLSLSANDBOX_PLAYER_DL_SHADERS
	bool "Download shaders from http://glslsandbox.com/"
	help
	  Download some shaders from http://glslsandbox.com/ to be
	  embedded in the binary

config BR2_PACKAGE_GLSLSANDBOX_PLAYER_PNG
	bool "Enable PNG support"
	select BR2_PACKAGE_LIBPNG
	help
	  Enable PNG texture loading support

config BR2_PACKAGE_GLSLSANDBOX_PLAYER_TESTING
	bool "Enable testing"
	help
	  Generate and install test suite on target

config BR2_PACKAGE_GLSLSANDBOX_PLAYER_SCRIPTS
	bool "Install scripts"
	depends on BR2_USE_MMU # bash, python
	depends on BR2_USE_WCHAR # python
	depends on BR2_TOOLCHAIN_HAS_THREADS # python
	depends on !BR2_STATIC_LIBS # python
	select BR2_PACKAGE_BUSYBOX_SHOW_OTHERS # bash
	select BR2_PACKAGE_PYTHON
	select BR2_PACKAGE_BASH
	select BR2_PACKAGE_LIBCURL
	select BR2_PACKAGE_CURL
	select BR2_PACKAGE_OPENSSL
	select BR2_PACKAGE_LIBOPENSSL_BIN if BR2_PACKAGE_LIBOPENSSL
	select BR2_PACKAGE_LIBRESSL_BIN if BR2_PACKAGE_LIBRESSL
	select BR2_PACKAGE_MAKE
	select BR2_PACKAGE_COREUTILS
	select BR2_PACKAGE_JPEG
	select BR2_PACKAGE_IMAGEMAGICK
	help
	  Install additional helper scripts

choice
	prompt "Native windowing system"
	default BR2_PACKAGE_GLSLSANDBOX_PLAYER_RPI   if BR2_PACKAGE_RPI_USERLAND
	default BR2_PACKAGE_GLSLSANDBOX_PLAYER_TISGX if BR2_PACKAGE_TI_SGX_UM
	default BR2_PACKAGE_GLSLSANDBOX_PLAYER_MALI  if BR2_PACKAGE_SUNXI_MALI_MAINLINE
	default BR2_PACKAGE_GLSLSANDBOX_PLAYER_WL    if BR2_PACKAGE_WAYLAND
	default BR2_PACKAGE_GLSLSANDBOX_PLAYER_X11   if BR2_PACKAGE_XORG7
	default BR2_PACKAGE_GLSLSANDBOX_PLAYER_SDL2  if BR2_PACKAGE_SDL2_OPENGLES
	help
	  Select the native windowing system you wish to use.

config BR2_PACKAGE_GLSLSANDBOX_PLAYER_KMS
	bool "KMS/DRM/GBM"
	select BR2_PACKAGE_LIBDRM

config BR2_PACKAGE_GLSLSANDBOX_PLAYER_VIVFB
	bool "Vivante Frame Buffer"
	depends on BR2_PACKAGE_IMX_GPU_VIV

config BR2_PACKAGE_GLSLSANDBOX_PLAYER_RPI
	bool "RaspberryPI Frame Buffer"
	depends on BR2_PACKAGE_RPI_USERLAND

config BR2_PACKAGE_GLSLSANDBOX_PLAYER_TISGX
	bool "TI/SGX Frame Buffer"
	depends on BR2_PACKAGE_TI_SGX_UM

config BR2_PACKAGE_GLSLSANDBOX_PLAYER_MALI
	bool "Allwinner ARM/Mali Frame Buffer"
	depends on BR2_PACKAGE_SUNXI_MALI_MAINLINE

config BR2_PACKAGE_GLSLSANDBOX_PLAYER_WL
	bool "Wayland"
	depends on BR2_PACKAGE_WAYLAND

config BR2_PACKAGE_GLSLSANDBOX_PLAYER_X11
	bool "X11"
	depends on BR2_PACKAGE_XORG7

config BR2_PACKAGE_GLSLSANDBOX_PLAYER_SDL2
	bool "SDL2"
	depends on BR2_PACKAGE_SDL2_OPENGLES

endchoice

if BR2_PACKAGE_GLSLSANDBOX_PLAYER_WL
config BR2_PACKAGE_GLSLSANDBOX_PLAYER_WL_IVI
	bool "Wayland IVI shell support"
endif

endif

comment "glslsandbox-player needs an openGL ES and EGL driver"
	depends on !BR2_PACKAGE_HAS_LIBEGL || !BR2_PACKAGE_HAS_LIBGLES
```

## package/octave-control/Config.in
```kconfig
config BR2_PACKAGE_OCTAVE_CONTROL
	bool "octave-control"
	select BR2_PACKAGE_OCTAVE
	help
	  octave-control

	  https://octave.sourceforge.io/control/
```

## package/python-defusedxml/Config.in
```kconfig
config BR2_PACKAGE_PYTHON_DEFUSEDXML
	bool "python-defusedxml"
	help
	  The python-defusedxml package contains several Python-only
	  workarounds and fixes for denial of service and other
	  vulnerabilities in Python's XML libraries. In order to
	  benefit from the protection you just have to import and use
	  the listed functions / classes from the right defusedxml
	  module instead of the original module.

	  https://github.com/tiran/defusedxml
```
