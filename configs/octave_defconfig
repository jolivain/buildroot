## package/ros/Config.in
```kconfig
menuconfig BR2_PACKAGE_ROS_SUPPORT
	bool "ROS: Robot Operating System"
	depends on BR2_INSTALL_LIBSTDCPP # boost
	depends on BR2_TOOLCHAIN_HAS_THREADS # boost
	depends on BR2_USE_WCHAR # boost
	# Most ROS core packages are using the host Catkin build
	# system, Boost and Python 3. We select those packages here so
	# they become implicit dependencies, to simplify Buildroot ROS
	# package recipes.
	select BR2_PACKAGE_BOOST
	select BR2_PACKAGE_HOST_CATKIN
	select BR2_PACKAGE_PYTHON3
	help
	  The Robot Operating System (ROS) is a set of software
	  libraries and tools that help you build robot
	  applications. From drivers to state-of-the-art algorithms,
	  and with powerful developer tools, ROS has what you need for
	  your next robotics project. And it's all open source.

	  https://www.ros.org/

	  Note on ROS Buildroot integration:

	  ROS components are split in small ROS-packages. Those small
	  packages are sometimes grouped in a collection, into a
	  single source package or repository. Each ROS-package is
	  exposed as a single Buildroot-package, to allow minimal
	  depedencies installations. The ROS-package collections
	  exposed in Buildroot correspond to a single source
	  package. Each collection includes a meta-package with the
	  same collection name, that will install the collection
	  metadata, and a common set of packages for this collection.
	  See: http://wiki.ros.org/Metapackages

if BR2_PACKAGE_ROS_SUPPORT
source "package/ros/actionlib/Config.in"
source "package/ros/angles/Config.in"
source "package/ros/bond_core/Config.in"
source "package/ros/catkin/Config.in"
source "package/ros/class_loader/Config.in"
source "package/ros/cmake_modules/Config.in"
source "package/ros/common_msgs/Config.in"
source "package/ros/console_bridge/Config.in"
source "package/ros/diagnostics/Config.in"
source "package/ros/dynamic_reconfigure/Config.in"
source "package/ros/gencpp/Config.in"
source "package/ros/geneus/Config.in"
source "package/ros/genlisp/Config.in"
source "package/ros/genmsg/Config.in"
source "package/ros/gennodejs/Config.in"
source "package/ros/genpy/Config.in"
source "package/ros/geographic_info/Config.in"
source "package/ros/geometry/Config.in"
source "package/ros/geometry2/Config.in"
source "package/ros/image_common/Config.in"
source "package/ros/mavlink/Config.in"
source "package/ros/mavros/Config.in"
source "package/ros/message_generation/Config.in"
source "package/ros/message_runtime/Config.in"
source "package/ros/orocos_kinematics_dynamics/Config.in"
source "package/ros/pluginlib/Config.in"
source "package/ros/python-catkin_pkg/Config.in"
source "package/ros/python-rosdep/Config.in"
source "package/ros/python-rosdistro/Config.in"
source "package/ros/python-rospkg/Config.in"
source "package/ros/ros/Config.in"
source "package/ros/ros_comm/Config.in"
source "package/ros/ros_comm_msgs/Config.in"
source "package/ros/ros_environment/Config.in"
source "package/ros/ros_tutorials/Config.in"
source "package/ros/rosconsole/Config.in"
source "package/ros/rosconsole_bridge/Config.in"
source "package/ros/roscpp_core/Config.in"
source "package/ros/rospack/Config.in"
source "package/ros/std_msgs/Config.in"
source "package/ros/unique_identifier/Config.in"
source "package/ros/vision_opencv/Config.in"
endif

comment "ROS needs a toolchain w/ C++, threads and wchar"
	depends on !BR2_TOOLCHAIN_HAS_THREADS \
		|| !BR2_INSTALL_LIBSTDCPP || !BR2_USE_WCHAR
```

## package/ros/actionlib/Config.in
```kconfig
config BR2_PACKAGE_ACTIONLIB
	bool "actionlib"
	select BR2_PACKAGE_ACTIONLIB_MSGS
	select BR2_PACKAGE_BOOST_CHRONO
	select BR2_PACKAGE_BOOST_FILESYSTEM
	select BR2_PACKAGE_BOOST_THREAD
	select BR2_PACKAGE_COMMON_MSGS_SET
	select BR2_PACKAGE_ROSCPP
	select BR2_PACKAGE_ROS_COMM_SET
	help
	  The actionlib package provides a standardized interface for
	  interfacing with preemptible tasks. Examples of this include
	  moving the base to a target location, performing a laser
	  scan and returning the resulting point cloud, detecting the
	  handle of a door, etc.

	  http://wiki.ros.org/actionlib

config BR2_PACKAGE_ACTIONLIB_ENABLE_TEST
	bool "actionlib test"
	depends on BR2_PACKAGE_ACTIONLIB
	select BR2_PACKAGE_ROSTEST
	help
	  enalbe actionlib test
```

## package/ros/angles/Config.in
```kconfig
config BR2_PACKAGE_ANGLES
	bool "angles"
	help
	  This package provides a set of simple math utilities to work
	  with angles. The utilities cover simple things like
	  normalizing an angle and conversion between degrees and
	  radians. But even if you're trying to calculate things like
	  the shortest angular distance between two joint space
	  positions of your robot, but the joint motion is constrained
	  by joint limits, this package is what you need. The code in
	  this package is stable and well tested.

	  http://wiki.ros.org/angles
```

## package/ros/bond_core/Config.in
```kconfig
menuconfig BR2_PACKAGE_BOND_CORE_SET
	bool "bond_core collection"

if BR2_PACKAGE_BOND_CORE_SET
source "package/ros/bond_core/bond/Config.in"
source "package/ros/bond_core/bond_core/Config.in"
source "package/ros/bond_core/bondcpp/Config.in"
source "package/ros/bond_core/bondpy/Config.in"
source "package/ros/bond_core/smclib/Config.in"
source "package/ros/bond_core/test_bond/Config.in"
endif
```

## package/ros/bond_core/bond/Config.in
```kconfig
config BR2_PACKAGE_BOND
	bool "bond"
	select BR2_PACKAGE_MESSAGE_GENERATION
	select BR2_PACKAGE_STD_MSGS
	help
	  bond package: a bond allows two processes, A and B, to know
	  when the other has terminated, either cleanly or by
	  crashing. The bond remains connected until it is either
	  broken explicitly or until a heartbeat times out.

	  http://wiki.ros.org/bond
```

## package/ros/bond_core/bond_core/Config.in
```kconfig
config BR2_PACKAGE_BOND_CORE
	bool "bond_core metapackage"
	select BR2_PACKAGE_BOND # runtime
	select BR2_PACKAGE_BONDCPP # runtime
	select BR2_PACKAGE_BONDPY # runtime
	select BR2_PACKAGE_SMCLIB # runtime
	help
	  bond_core metapackage: A bond allows two processes, A and B,
	  to know when the other has terminated, either cleanly or by
	  crashing. The bond remains connected until it is either
	  broken explicitly or until a heartbeat times out.

	  This metapackage selects common packages for this
	  collection.

	  http://wiki.ros.org/bond_core
```

## package/ros/bond_core/bondcpp/Config.in
```kconfig
config BR2_PACKAGE_BONDCPP
	bool "bondcpp"
	select BR2_PACKAGE_BOND
	select BR2_PACKAGE_CMAKE_MODULES
	select BR2_PACKAGE_ROSCPP
	select BR2_PACKAGE_ROS_COMM_SET
	select BR2_PACKAGE_SMCLIB
	select BR2_PACKAGE_UTIL_LINUX
	select BR2_PACKAGE_UTIL_LINUX_LIBUUID
	help
	  C++ implementation of bond, a mechanism for checking when
	  another process has terminated.

	  http://wiki.ros.org/bondcpp
```

## package/ros/bond_core/bondpy/Config.in
```kconfig
config BR2_PACKAGE_BONDPY
	bool "bondpy"
	help
	  Python implementation of bond, a mechanism for checking when
	  another process has terminated.

	  http://wiki.ros.org/bondpy
```

## package/ros/bond_core/smclib/Config.in
```kconfig
config BR2_PACKAGE_SMCLIB
	bool "smclib"
	help
	  The State Machine Compiler (SMC) from
	  http://smc.sourceforge.net/ converts a language-independent
	  description of a state machine into the source code to
	  support that state machine. This package contains the
	  libraries that a compiled state machine depends on, but it
	  does not contain the compiler itself.

	  http://wiki.ros.org/smclib
```

## package/ros/bond_core/test_bond/Config.in
```kconfig
config BR2_PACKAGE_TEST_BOND
	bool "test_bond"
	select BR2_PACKAGE_BONDCPP
	select BR2_PACKAGE_CMAKE_MODULES
	select BR2_PACKAGE_MESSAGE_GENERATION
	select BR2_PACKAGE_ROSTEST
	help
	  test bond
```

## package/ros/catkin/Config.in
```kconfig
config BR2_PACKAGE_CATKIN
	bool "catkin"
	select BR2_PACKAGE_PYTHON_CATKIN_PKG # runtime
	help
	  Low-level build system macros and infrastructure for ROS.

	  http://wiki.ros.org/catkin
```

## package/ros/catkin/Config.in.host
```kconfig
config BR2_PACKAGE_HOST_CATKIN
	bool "host catkin"
	select BR2_PACKAGE_HOST_PYTHON_CATKIN_PKG
	select BR2_PACKAGE_HOST_PYTHON_EMPY
	help
	  Low-level build system macros and infrastructure for ROS.

	  http://wiki.ros.org/catkin
```

## package/ros/cmake_modules/Config.in
```kconfig
config BR2_PACKAGE_CMAKE_MODULES
	bool "cmake modules"
	help
	  A common repository for CMake Modules which are not
	  distributed with CMake but are commonly used by ROS
	  packages.

	  http://wiki.ros.org/cmake_modules
```

## package/ros/common_msgs/Config.in
```kconfig
menuconfig BR2_PACKAGE_COMMON_MSGS_SET
	bool "common_msgs collection"
	select BR2_PACKAGE_CPP_COMMON
	select BR2_PACKAGE_MESSAGE_GENERATION
	select BR2_PACKAGE_MESSAGE_RUNTIME
	select BR2_PACKAGE_ROSCPP_CORE_SET
	select BR2_PACKAGE_ROSCPP_SERIALIZATION
	select BR2_PACKAGE_STD_MSGS

if BR2_PACKAGE_COMMON_MSGS_SET
source "package/ros/common_msgs/actionlib_msgs/Config.in"
source "package/ros/common_msgs/common_msgs/Config.in"
source "package/ros/common_msgs/diagnostic_msgs/Config.in"
source "package/ros/common_msgs/geometry_msgs/Config.in"
source "package/ros/common_msgs/nav_msgs/Config.in"
source "package/ros/common_msgs/sensor_msgs/Config.in"
source "package/ros/common_msgs/shape_msgs/Config.in"
source "package/ros/common_msgs/stereo_msgs/Config.in"
source "package/ros/common_msgs/trajectory_msgs/Config.in"
source "package/ros/common_msgs/visualization_msgs/Config.in"
endif
```
